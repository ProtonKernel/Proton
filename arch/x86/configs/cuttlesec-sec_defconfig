## drivers/battery/common/Kconfig
```kconfig
config DIRECT_CHARGING
	tristate "support for direct charging"
	help
	 Say Y to include support for direct charging
	 support for direct charging models.
	 Direct charging models should enable this charging option.
	 it include some charging scenario for direct charging models.


menu "Samsung Battery Common drivers"

config BATTERY_SAMSUNG
	tristate "samsung battery driver"
	help
	  Say Y to include support for samsung battery driver
	  This battery driver integrated all battery-related functions
	  To see battery-related functions,
	  refer to sec_charging_common.h

config CHARGING_VZWCONCEPT
	bool "VZW concept about the charging"
	default n
	depends on BATTERY_SAMSUNG
	help
	  Say Y here to enable
	  support for apply the VZW concepts.
	  VZW models should enable this charging option.
	  it include some charging scenario for VZW models.

config STEP_CHARGING
	bool "support for step charging"
	help
	  Say Y here to enable
	  support for step charging.
	  it could be used with direct charging.
	  it needs step charging tables.

config ENABLE_FULL_BY_SOC
	bool "make full by soc 100%"
	help
	default n
	  Say Y here to enable
	  support to make full charged by soc 100%.
	  If this is N in models,
	  battery common drivers make full by other conditions.

config SEC_PD
	tristate "support for sec pd"
	help
	 Say Y to include support for sec pd control module.
	 This sec_pd driver integrated all pdo related function.
	 To see pdo related functions,
	 refer to sec_pd.h

config UPDATE_BATTERY_DATA
	bool "support for updating battery data"
	default n
	depends on BATTERY_SAMSUNG && OF
	help
	  Say Y here to enable
	  support for update battery data.
	  This integrated load and parsing data functions again.
	  it need to battery data file for update.

config BATTERY_CISD
	bool "support for cisd"
	help
	  Say Y here to enable
	  support for CISD.
	  cisd means cell internal short detection.
	  it include some other detection.

config AFC_CHARGER_MODE
	bool "afc charging support in sec battery driver"
	default n
	help
	  Say Y here to enable
	  support for sec afc charging support
	  it includes some AFC charging options and
	  information about AFC charging.

config SAMSUNG_BATTERY_ENG_TEST
	bool "enable ENG mode for battery test"
	default n
	help
	  Say Y to include support for battery test
	  enable this feature only ENG mode
	  this featuren must disabled user binary
	  stability test etc..

config SAMSUNG_BATTERY_FACTORY
	bool "enable for factory test"
	default n
	help
	  Say Y to include support for factory test
	  enable this feature only factory mode
	  this featuren must disabled user binary
	  stability test etc..

config USE_POGO
	bool "enable pogo charging"
	default n
	help
	  Say Y here to enable
	  support POGO properties.
	  some models support POGO,
	  then it make Y.

config STORE_MODE
	bool "enable store mode"
	default n
	help
	  Say Y here to enable
	  support store mode charging concpet.
	  The LDU or RDU enable this STORE_MODE option,
	  it include some charging scenario for store.

config BATTERY_AGE_FORECAST
	bool "battery age forecast"
	default n
	help
	  Say Y here to enable
	  support AGE FORECAST functions.
	  it include some charging scenario for aged batteries.
	  it need age forecast charging tables.

config ENG_BATTERY_CONCEPT
	bool "enable temp block"
	default n
	help
	  Say Y here to enable
	  support CONFIG_ENG_BATTERY_CONCEPT.
	  It is for only in ENG bianry
	  USER binary should disalbe this.

config LIMIT_CHARGING_DURING_CALL
	bool "limit charging during call"
	default n
	help
	  Say Y here to enable
	  support limit charging during call.
	  some models support this for limiting charging current,
	  then it make Y.

config TABLET_MODEL_CONCEPT
	bool "tablet model concept"
	default n
	help
	  Say Y here to enable
	  do not enable for cellphone models.
	  tablet models support this for charging,
	  then it make Y.

config PREVENT_USB_CONN_OVERHEAT
    bool "enable prevent usb conn overheat"
    default n
    help
	  Say Y here to enable
	  support CONFIG_PREVENT_USB_CONN_OVERHEAT.
	  this is for prevent thermal usb conn.
	  it include some charging scenario for thermal usb conn.

config PD_CHARGER_HV_DISABLE
    bool "enable supporing disable high voltage pd charger"
    depends on BATTERY_SAMSUNG && I2C
    help
	  Say Y here to enable
	  supporting disable high voltage pd charger.
	  some models need this for support options that
	  not support high voltage.

config BATTERY_GKI
    bool "temporary support for GKI build"
    help
	  Say Y here to enable
	  support for module build normally.
	  this is temporary added for prevent build break in module build.
	  it will be deleted soon.

config SUPPORT_SHIP_MODE
    bool "support ship mode"
    default n
    help
	  Say Y here to enable
	  support to ship mode.
	  If this is N in models,
	  not support to ship mode.

config SUPPORT_HV_CTRL
    bool "support for controlling voltage"
    default n
    help
	  Say Y here to enable
	  support for controlling voltage
	  If this is N in models,
	  not support to control voltage.

config SEC_BATTERY_TEST
	bool "KUnit test for sec_battery_test"
	depends on SEC_KUNIT
	help
    	  Say Y here to enable
	  support to kunit test.
	  for kunitest
          for sec_battery_test

config SEC_BATTERY_WC_TEST
	bool "KUnit test for sec_battery_wc_test"
	depends on SEC_KUNIT
	help
    	  Say Y here to enable
	  support to kunit test.
	  for kunitest
          for sec_battery_wc_test

config SEC_BATTERY_THERMAL_TEST
	bool "KUnit test for sec_battery_thermal_test"
	depends on SEC_KUNIT
	help
    	  Say Y here to enable
	  support to kunit test.
	  for kunitest
          for sec_battery_thermal_test

config SEC_BATTERY_VOTE_TEST
    bool "KUnit test for sec_battery_vote_test"
    depends on SEC_KUNIT
    help
    	  Say Y here to enable
	  support to kunit test.
	  for kunitest
          for sec_battery_vote_test

config SEC_CISD_TEST
	bool "KUnit test for sec_cisd_test"
	depends on SEC_KUNIT
	help
    	  Say Y here to enable
	  support to kunit test.
	  for kunitest
          for sec_cisd_test

config SEC_ADC_TEST
	bool "KUnit test for sec_adc_test"
	depends on SEC_KUNIT
	help
    	  Say Y here to enable
	  support to kunit test.
	  for kunitest
          for sec_adc_test

config SEC_BATTERY_SYSFS_TEST
	bool "KUnit test for sec_battery_sysfs_test"
	depends on SEC_KUNIT
	help
    	  Say Y here to enable
	  support to kunit test.
	  for kunitest
          for sec_battery_sysfs_test

config SEC_BATTERY_TTF_TEST
	bool "KUnit test for sec_battery_ttf_test"
	depends on SEC_KUNIT
	help
    	  Say Y here to enable
	  support to kunit test.
	  for kunitest
          for sec_battery_ttf_test

config SEC_STEP_CHARGING_TEST
	tristate "KUnit test for sec_step_charging_test"
	depends on SEC_KUNIT
	help
    	  Say Y here to enable
	  support to kunit test.
	  for kunitest
          for sec_step_charging_test

config SEC_PD_TEST
	bool "KUnit test for sec_pd_test"
	depends on SEC_KUNIT
	help
    	  Say Y here to enable
	  support to kunit test.
	  for kunitest
          for sec_pd_test

config SEC_BATTERY_DT_TEST
	bool "KUnit test for sec_battery_dt_test"
	depends on SEC_KUNIT
	help
    	  Say Y here to enable
	  support to kunit test.
	  for kunitest
          for sec_pd_test

config SEC_BATTERY_MISC_TEST
	bool "KUnit test for sec_battery_misc_test"
	depends on SEC_KUNIT
	help
    	  Say Y here to enable
	  support to kunit test.
	  for kunitest
          for sec_pd_test
endmenu
```

## drivers/battery/fuelgauge/max77705_fuelgauge/Kconfig
```kconfig
menu "Fuelgauge drivers"

config FUELGAUGE_DUMMY
	bool "dummy fuel gauge driver"
	default n
	depends on BATTERY_SAMSUNG
	help
	  Say Y here, to enable
	  support for dummy fuel gauge driver.
	  This driver source code implemented
	  skeleton source code for fuel gauge functions.

config FUELGAUGE_MAX77705
	tristate "MAX77705 fuel gauge driver"
	default n
	depends on BATTERY_SAMSUNG
	help
	  Say Y or M here, to enable
	  support for MAXIM MAX77705 fuel gauge driver.
	  This is fuel-gauge systems for monitoring batteries.
	  This fuel-gauge can be used in coulomb-counting mode.

config EN_OOPS
	bool "enable oops filter"
	default n
	help
	  Say Y here to enable
	  support for FUELGAUGE_MAX77705 enable oops filter.
	  MAXIM fuel-gauge only support this option.
	  some battery data values should be defined.

config FUELGAUGE_MAX77705_TEST
	tristate "KUnit test for max77705_fuelgauge_test"
	depends on SEC_KUNIT
	help
	  Say Y here to enable
	  support to kunit test.
	  for kunitest
	  for max77705_fuelgauge_test

endmenu
```

## drivers/battery/wireless/Kconfig
```kconfig
menu "Wireless Charger drivers"

config WIRELESS_CHARGING
	tristate "support for wireless charging"
	depends on WIRELESS_CHARGER_MFC
	help
	 Say Y to include support for wireless charging.
	 Wireless charging models should enable this charging option.
	 it include various scenario for wireless charging models only.

config WIRELESS_CHARGER_MFC
	tristate "MFC IC charger support"
	select WIRELESS_CHARGING
	depends on BATTERY_SAMSUNG && I2C
	help
	  Say Y here, to enable
	  support for the MFC IC
	  MFC include wireless charger driver.
	  It is for IDT.

config WIRELESS_NO_HV
	bool "wireless no hv"
	depends on BATTERY_SAMSUNG && I2C
	help
	  Say Y here to enable
	  support for disable HV wireless charging.
	  If you are unsure, say N.
	  some models need this for not support high voltage wireless charging.

config WIRELESS_AUTH
	bool "support for samsung wireless authentication massage"
	default n
	depends on WIRELESS_CHARGING
	help
	  Say Y here to enable
	  support for wireless authentication message.
	  It is for samsung wireless authentication.
	  wireless charging flagship models should enable this option.

config WIRELESS_CHARGER_HIGH_VOLTAGE
	bool "high voltage wireless charger"
	default n
	depends on WIRELESS_CHARGING
	help
	  Say Y here to enable
	  support for wireless fast charging.
	  It is for fast wireless charging.
	  wireless charging flagship models should enable this option.

config WIRELESS_TX_MODE
	bool "wireless power sharing support in sec battery driver"
	default n
	depends on WIRELESS_CHARGING
	help
	  Say Y here to enable
	  support for wireless tx mode.
	  It is for wireless power sharing.
	  wireless tx support models should enable this option.

config WIRELESS_FIRMWARE_UPDATE
	bool "WIRELESS IC firmware update support"
	default n
	depends on WIRELESS_CHARGING
	help
	  Say Y here to enable
	  support for the wireless charger IC firmware update.
	  it need firmware bin in firmware folder.
	  It is for MFC IC.

config WIRELESS_IC_PARAM
	bool "WIRELESS IC info param support"
	depends on WIRELESS_CHARGING
	help
	  Say Y here to enable
	  support for the WIRELESS IC info param.
	  It is for wireless ic dualization.
	  such as use of IDT and LSI.

config TX_GEAR_PHM_VOUT_CTRL
    bool "control vout when gear`s phm"
    default n
    depends on WIRELESS_TX_MODE
    help
	  Say Y to enable CONFIG_TX_GEAR_PHM_VOUT_CTRL
	  Control vout 5v when enter gear`s phm with high voltage wired charging
	  Recover vout when escape gear`s phm
	  This is considered only if high vout with gear.

config TX_GEAR_AOV
    bool "control adaptive vout when tx gear"
    default n
    depends on WIRELESS_TX_MODE
    help
	  Say Y to enable CONFIG_TX_GEAR_AOV
	  AOV : Adaptive Operation Voltage
	  When tx gear, control vout adaptively.
	  This is for tx gear with thick cover.

config ENABLE_WIRELESS_IRQ_IN_SLEEP
	bool "support for enable irq in sleep"
	default n
	depends on WIRELESS_CHARGING
	help
	  Say Y here to enable
	  support for enable irq in sleep
	  In Qualcomm AP, wireless charging does not work,
	  when irq is disabled in sleep .

endmenu
```

## drivers/gpu/arm/Kconfig
```kconfig
#
# (C) COPYRIGHT 2012 ARM Limited. All rights reserved.
#
# This program is free software and is provided to you under the terms of the
# GNU General Public License version 2 as published by the Free Software
# Foundation, and any use by you of this program is subject to the terms
# of such GNU licence.
#
# This program is distributed in the hope that it will be useful,
# but WITHOUT ANY WARRANTY; without even the implied warranty of
# MERCHANTABILITY or FITNESS FOR A PARTICULAR PURPOSE. See the
# GNU General Public License for more details.
#
# You should have received a copy of the GNU General Public License
# along with this program; if not, you can access it online at
# http://www.gnu.org/licenses/gpl-2.0.html.
#
# SPDX-License-Identifier: GPL-2.0
#
#

menu "ARM GPU Configuration"

choice
	prompt "Mali Version Configuration"
	default MALI_DDK_VALHALL_R32P1 if $(SEC_BUILD_CONF_VENDOR_BUILD_OS) <= 12
	default MALI_DDK_VALHALL_R32P1 if $(SEC_BUILD_CONF_VENDOR_BUILD_OS) = 13
	default MALI_DDK_VALHALL_R38P0 if $(SEC_BUILD_CONF_VENDOR_BUILD_OS) >= 14

	help
	  Select Mali GPU driver version.

config MALI_DDK_NONE
	bool "None"

config MALI_DDK_VALHALL_R20P0
	bool "Valhall r20p0"

config MALI_DDK_VALHALL_R23P0
	bool "Valhall r23p0 driver"

config MALI_DDK_VALHALL_R24P0
	bool "Valhall r24p0 driver"

config MALI_DDK_VALHALL_R25P1
	bool "Valhall r25p1 driver"

config MALI_DDK_VALHALL_R26P0
	bool "Valhall r26p0 driver"

config MALI_DDK_VALHALL_R32P1
	bool "Valhall r32p1 driver"

config MALI_DDK_VALHALL_R38P0
	bool "Valhall r38p0 driver"

config MALI_DDK_VALHALL_R38P1
	bool "Valhall r38p1 driver"

endchoice

if MALI_DDK_VALHALL_R20P0
source "drivers/gpu/arm/v_r20p0/Kconfig"
endif

if MALI_DDK_VALHALL_R23P0
source "drivers/gpu/arm/v_r23p0/Kconfig"
endif

if MALI_DDK_VALHALL_R24P0
source "drivers/gpu/arm/v_r24p0/Kconfig"
endif

if MALI_DDK_VALHALL_R25P1
source "drivers/gpu/arm/bv_r25p1/Kconfig"
endif

if MALI_DDK_VALHALL_R26P0
source "drivers/gpu/arm/bv_r26p0/Kconfig"
endif

if MALI_DDK_VALHALL_R32P1
source "drivers/gpu/arm/bv_r32p1/Kconfig"
endif

if MALI_DDK_VALHALL_R38P0
source "drivers/gpu/arm/bv_r38p0/Kconfig"
endif

if MALI_DDK_VALHALL_R38P1
source "drivers/gpu/arm/bv_r38p1/Kconfig"
endif

endmenu
```
