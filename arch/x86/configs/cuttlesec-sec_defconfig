## drivers/input/sec_input/synaptics/Kconfig
```kconfig
# SPDX-License-Identifier: GPL-2.0-only
#
# SLSI TOUCH driver configuration
#

config TOUCHSCREEN_SYNAPTICS
	tristate "SYNAPTICS Touchscreen"
	depends on I2C
    help
      Say Y here if you want support for SEC touchscreen controllers.
      If unsure, say N.
```

## drivers/kq/balancer/Kconfig
```kconfig
config SEC_KQ_BALANCER
	tristate "Samsung KQ Balancer support"
	default n
	depends on DRV_SAMSUNG && SEC_FACTORY
	help
	  This option enables Samsung KQ Balancer feature.
	  This module acts as a module that adjusts frequency balance.
	  Enable this feature for checking frequency stability.
	  This module only works with nbd daemon.
```

## drivers/kq/nad/Kconfig
```kconfig
comment "Samsung NAD Options"
config SEC_KQ_NAD
	tristate "Samsung NAD Feature"
	depends on SEC_FACTORY && DRV_SAMSUNG
	default n
	help
	  Samsung NAD Feature, support AT CMD for NAD 2.0
	  This driver works to gather NAD result information generated by bootloader.
	  It can be expanded for other functions such as NAD API, NAD PMIC, MOTTO,
	  BPS as well.

comment "Samsung NAD V2 Options"
config SEC_KQ_NAD_V2
	tristate "Samsung NAD V2 Feature"
	depends on SEC_KQ_NAD
	default n
	help
	  Samsung NAD Feature, support AT CMD for NAD 2.0
	  This driver supports NAD v2 and works to gather NAD result information 
	  generated by bootloader. It can be expanded for other functions 
	  such as NAD API, NAD PMIC, MOTTO, BPS as well.

comment "Samsung NAD X Support Options"
config SEC_KQ_NAD_X
	tristate "Samsung TN NAD X Feature"
	depends on SEC_KQ_NAD
	default n
	help
	  Samsung TN NAD Feature, Enable NAD X
	  no matter AP chipset vendor, You can make your own vector list
	  you want to test.
	  This feature depends on SEC_KQ_NAD.

comment "Samsung NAD ver5.5 Support Options"
config SEC_KQ_NAD_55
	tristate "Samsung TN NAD USB Feature"
	depends on SEC_KQ_NAD
	default n
	help
	  Samsung TN NAD Feature, Enable NAD USB
	  This feature support NAD 5.5
	  This feature depends on SEC_KQ_NAD.

comment "Samsung NAD vdd_cal Support Options"
config SEC_KQ_NAD_VDD_CAL
	tristate "Samsung TN NAD VDD CAL Feature"
	depends on SEC_KQ_NAD
	default n
	help
	  Samsung TN NAD Feature, Enable VDD CAL
	  This feature support to get vdd cal data.
	  This feature depends on SEC_KQ_NAD.

comment "Samsung NAD ver5.5 Support Options"
config ARM_EXYNOS_ACME_DISABLE_BOOT_LOCK
	tristate "Samsung TN NAD 5.5 Feature"
	depends on SEC_KQ_NAD
	default n
	help
	  Samsung TN NAD 5.5 Feature, Enable CPU_FREQ_FLEXBOOT
	  This feature support NAD 5.5
	  This feature depends on SEC_KQ_NAD.

comment "Samsung NAD ver5.5 Support Options"
config ARM_EXYNOS_DEVFREQ_DISABLE_BOOT_LOCK
	tristate "Samsung TN NAD 5.5 Feature"
	depends on SEC_KQ_NAD
	default n
	help
	  Samsung TN NAD 5.5 Feature, Enable DEV_FREQ_FLEXBOOT
	  This feature support NAD 5.5
	  This feature depends on SEC_KQ_NAD.

comment "Samsung Correlation information"
config SEC_KQ_CORRELATION_RESULT
	tristate "Samsung ASVG-VDDCAL Correlation"
	depends on SEC_KQ_NAD
	default n
	help
	  Samsung ASVG-VDDCAL Correlation information
	  checking relationship between base and real voltage
	  This feature only working exynos2100
	  This feature depends on SEC_KQ_NAD

comment "Samsung BPS Classifier information"
config SEC_KQ_BPS_RESULT
	tristate "Samsung BPS classifier result"
	depends on SEC_KQ_NAD
	default n
	help
	  Samsung BPS Classifier information
	  add BPS result to nad result
	  This feature works factory binary
	  This feature depends on SEC_KQ_NAD

config SEC_KQ_NAD_API
	bool "Samsung NAD API"
	depends on SEC_KQ_NAD
	default n
	help
	  Samsung NAD API Feature, Enable NAD_API_TEST
	  checking whether pmic is normal or abnormal
	  This feature works factory binary
	  This feature depends on SEC_KQ_NAD
```

## drivers/mcps/Kconfig
```kconfig
#
# MCPS configuration
#
config MCPS
	tristate "MCPS configuration"
	default n
	help
		It will improve RPS mechanism using A-RPS(Advanced RPS) .
		A-RPS allow available core to take a more network flow.

config MCPS_GRO_ENABLE
    bool "Enable GRO on MCPS"
    default y
    depends on MCPS
    help
        It will allow MCPS to enable Generic Receive Offload(GRO)

config MCPS_DEBUG_PRINTK
	int "MCPS Debugging printk"
	default 3
	depends on MCPS
	help
		It occur a printk at all time. It may be cause a sluggish.
		So It should be false on Device for sales or testing of performance.

config MQTCP_DEBUG_PRINTK
    bool "MQTCP Debugging printk"
    default n
    depends on MCPS
    help
        It occur a printk at all time. It may be cause a sluggish.
        So It should be false on Device for sales or testing of performance.

config MCPS_DEBUG_SYSTRACE
    bool "MCPS debugging systrace"
    default n
    depends on MCPS
    help
        Test...

config MCPS_DEBUG
    bool "MCPS debug dump"
    default y
    depends on MCPS
    help
        ....

config MCPS_CHUNK_GRO
    bool "MCPS one chunk one gro"
    default y
    depends on MCPS
    help
        ....

config MCPS_ICB
    bool "MCPS Initial Connection Booster"
    default n
    depends on MCPS && ARCH_EXYNOS
    help
        Improving initial TCP throughput by cpu frequency boosting and adaptive gro setting

config MCPS_V2
    bool "MCPS v2"
    default y
    depends on MCPS
    help
        The MCPS v2 adopts some of the GRO function chains.
        This allows more detailed operation of GRO and to lead GROed packets to ARPS after GRO flush.

config MCPS_GRO_PER_SESSION
    bool "MCPS gro per session"
    default y
    depends on MCPS
    help
        Determines the number of packets to be combined using GRO per session.

config MCPS_ICGB
    bool "MCPS Initial Connection GRO Booster"
    default y
    depends on MCPS && MCPS_GRO_PER_SESSION=y
    help
        Adjust GRO policy according to the features of the session to optimize the throughput of the session.

config MCPS_KUNIT
    bool "KUnit test for mcps"
    depends on SEC_KUNIT
    help
        TODO: Describe config fully
        kunit test sets

config MCPS_ON_EXYNOS
    bool "MCPS on Exynos SoC"
    default y
    depends on SOC_EXYNOS2100 || SOC_EXYNOS9830 || SOC_EXYNOS9820
    help
        TODO: Describe config fully
        Configuration of MCPS on Exynos series SoC.
```

## drivers/media/platform/exynos/Kconfig
```kconfig
#
# Exynos multimedia device drivers
#
config VIDEO_EXYNOS
        bool "Exynos Multimedia Devices"
        default y
        help
          This is a representative exynos multimedia device.

if VIDEO_EXYNOS
        source "drivers/media/platform/exynos/repeater/Kconfig"
        source "drivers/media/platform/exynos/tsmux/Kconfig"
        source "drivers/media/platform/exynos/mfc/Kconfig"
        source "drivers/media/platform/exynos/camera/Kconfig"
        source "drivers/media/platform/exynos/camera-pp/Kconfig"
        source "drivers/media/platform/exynos/jsqz/Kconfig"
        source "drivers/media/platform/exynos/mcfrc/Kconfig"
endif

config MEDIA_EXYNOS
        bool
        depends on VIDEO_EXYNOS
        default y
        help
          Compile mdev to use exynos media device driver.
```

## drivers/media/platform/exynos/camera-pp/gdc/Kconfig
```kconfig
menuconfig VIDEO_EXYNOS_CAMERA_POSTPROCESS_GDC
	tristate "EXYNOS CAMERA POSTPROCESS GDC Driver"
	depends on VIDEO_EXYNOS_CAMERA_POSTPROCESS
	default y
	help
		This is a representative exynos CAMERA-PP GDC device.

config CAMERA_PP_GDC_V1_0_0_OBJ
	tristate "use GDC v1.0"
	depends on VIDEO_EXYNOS_CAMERA_POSTPROCESS_GDC
	default n
	help
		Use to build GDC v1.0 driver

config CAMERA_PP_GDC_V2_0_0_OBJ
	tristate "use GDC v2.0"
	depends on VIDEO_EXYNOS_CAMERA_POSTPROCESS_GDC
	default n
	help
		Use to build GDC v2.0 driver

config CAMERA_PP_GDC_V2_1_0_OBJ
	tristate "use GDC v2.1"
	depends on VIDEO_EXYNOS_CAMERA_POSTPROCESS_GDC
	default n
	help
		Use to build GDC v2.1 driver

config CAMERA_PP_GDC_V3_0_0_OBJ
	tristate "use GDC v3.0"
	depends on VIDEO_EXYNOS_CAMERA_POSTPROCESS_GDC
	default n
	help
		Use to build GDC v3.0 driver


config CAMERA_PP_GDC_V3_1_0_OBJ
	tristate "use GDC v3.1"
	depends on VIDEO_EXYNOS_CAMERA_POSTPROCESS_GDC
	default n
	help
		Use to build GDC v3.1 driver

config CAMERA_PP_GDC_V3_10_0_OBJ
	tristate "use GDC v3.10"
	depends on VIDEO_EXYNOS_CAMERA_POSTPROCESS_GDC
	default n
	help
		Use to build GDC v3.10 driver

config CAMERA_PP_GDC_V4_1_0_OBJ
	tristate "use GDC v4.1"
	depends on VIDEO_EXYNOS_CAMERA_POSTPROCESS_GDC
	default n
	help
		Use to build GDC v4.1 driver
```

## drivers/media/platform/exynos/camera-pp/pd_mgr/Kconfig
```kconfig
config VIDEO_EXYNOS_CAMERA_POSTPROCESS_PD_MGR
	tristate "EXYNOS CAMERA POSTPROCESS POWER DOMAIN MANAGER Driver"
	depends on VIDEO_EXYNOS_CAMERA_POSTPROCESS
	default n
	help
		Use to build Camera Postprocess power domain manager driver
```

## drivers/media/platform/exynos/camera-pp/votf/Kconfig
```kconfig
menuconfig VIDEO_EXYNOS_CAMERA_POSTPROCESS_VOTF
	tristate "EXYNOS CAMERA POSTPROCESS VOTF Driver"
	depends on VIDEO_EXYNOS_CAMERA_POSTPROCESS
	default n
	help
		This is a representative exynos CAMERA-PP VOTF device.
```

## drivers/media/platform/exynos/camera/Kconfig
```kconfig
config VIDEO_EXYNOS_PABLO_ISP
	tristate "Exynos Pablo Camera Driver"
	depends on VIDEO_EXYNOS
	select MEDIA_EXYNOS
	select VIDEO_EXYNOS_FIMC_IS2
	select EXYNOS_PABLO_ISP
	select VIDEOBUF2_DMA_SG
	default n
	help
	  This is a v4l2 driver for exynos FIMC-IS device.

config DISABLE_CAMERA_MEM_ATTR
	bool "Disable memory attr change"
	depends on VIDEO_EXYNOS_PABLO_ISP
	default n

config DISABLE_CAMERA_SIMD
	bool "Disable simd ops"
	depends on VIDEO_EXYNOS_PABLO_ISP
	default n

config CAMERA_DVFS_V2
	bool "Use Camera DVFS V2"
	depends on EXYNOS_PABLO_ISP
	default n
	help
		Enable Camera DVFS v2 feature.

# Chain driver
source "drivers/media/platform/exynos/camera/ischain/Kconfig"
source "drivers/media/platform/exynos/camera/hardware/Kconfig"
source "drivers/media/platform/exynos/camera/vendor/Kconfig"

# Sensor driver
source "drivers/media/platform/exynos/camera/sensor/Kconfig"
```

## drivers/media/platform/exynos/camera/hardware/Kconfig
```kconfig
config USE_SENSOR_GROUP
	bool "Use sensor group feature"
	depends on EXYNOS_PABLO_ISP
	default y
	help
	  Enalbe sensor group feature.

config CAMERA_PDP
	bool "Use PDP"
	depends on EXYNOS_DEVICE_CAMERA_MODULE
	depends on EXYNOS_PABLO_ISP
	default n
	help
	  Use to build PDP.

source "drivers/media/platform/exynos/camera/hardware/api/Kconfig"
```

## drivers/media/platform/exynos/camera/hardware/api/Kconfig
```kconfig
config MC_SCALER_V5_0
	bool "Use MC-SCALER H/W v5.0"
	depends on EXYNOS_PABLO_ISP
	default n
	help
	  use mc-scaler v5.0

config MC_SCALER_V8_0
	bool "Use MC-SCALER H/W v8.0"
	depends on EXYNOS_PABLO_ISP
	default n
	help
	  use mc-scaler v8.0

config MC_SCALER_V8_1
	bool "Use MC-SCALER H/W v8.1"
	depends on EXYNOS_PABLO_ISP
	default n
	help
	  use mc-scaler v8.1

config MC_SCALER_V8_10
	bool "Use MC-SCALER H/W v8.10"
	depends on EXYNOS_PABLO_ISP
	default n
	help
	  use mc-scaler v8.10

config MC_SCALER_V8_20
	bool "Use MC-SCALER H/W v8.20"
	depends on EXYNOS_PABLO_ISP
	default n
	help
	  use mc-scaler v8.20

config MC_SCALER_V9_1
	bool "Use MC-SCALER H/W v9.1"
	depends on EXYNOS_PABLO_ISP
	default n
	help
	  use mc-scaler v9.1

config VRA_V2_0
	bool "Use VRA H/W v2.0"
	depends on EXYNOS_PABLO_ISP
	default n
	help
	  use vra v2.0

config PDP_V1_0
        bool "Use PDP H/W v1.0"
	depends on EXYNOS_PABLO_ISP
        default n
        help
          use PDP v1.0

config PDP_V1_0_0
        bool "Use PDP H/W v1.0.0"
	depends on EXYNOS_PABLO_ISP
        default n
        help
          use PDP v1.0.0

config PDP_V3_1
        bool "Use PDP H/W v3.1"
	depends on EXYNOS_PABLO_ISP
        default n
        help
          use PDP v3.1

config YUVPP_V2_1
        bool "Use YUVPP H/W v2.1"
	depends on EXYNOS_PABLO_ISP
        default n
        help
          use YUVPP v2.1
```
