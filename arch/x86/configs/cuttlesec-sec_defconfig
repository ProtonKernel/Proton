## drivers/gpu/arm/bv_r26p0/platform/exynos/Kconfig
```kconfig
#
# (C) COPYRIGHT 2012 ARM Limited. All rights reserved.
#
# This program is free software and is provided to you under the terms of the
# GNU General Public License version 2 as published by the Free Software
# Foundation, and any use by you of this program is subject to the terms
# of such GNU licence.
#
# A copy of the licence is included with the program, and can also be obtained
# from Free Software Foundation, Inc., 51 Franklin Street, Fifth Floor,
# Boston, MA  02110-1301, USA.
#
#




# Add your platform specific Kconfig file here
#
# "drivers/gpu/arm/.../platform/Kconfig"
#
# Where xxx is the platform name is the name set in MALI_PLATFORM_THIRDPARTY_NAME
#
config EXYNOS_SOC_NAME
    depends on MALI_MIDGARD
    string "Third party soc name"
    help
      soc name.

config MALI_DVFS
    bool "Enable EXYNOS DVFS"
    depends on MALI_MIDGARD
    default n
    help
      Choose this option to enable DVFS in the Mali Midgard DDK.

config MALI_FG_DVFS
    bool "Enable EXYNOS DVFS"
    depends on MALI_MIDGARD
    depends on CAL_IF
    depends on MALI_DVFS
    default y
    help
      Choose this option use Fine Grain CAL IF for Mali DVFS.

config MALI_RT_PM
    bool "Enable EXYNOS Runtime power management"
    depends on MALI_MIDGARD
    depends on PM
    depends on EXYNOS_PD
    default n
    help
      Choose this option to enable runtime power management in the Mali Midgard DDK.

config MALI_EXYNOS_TRACE
    bool "Enable EXYNOS kbase tracing"
    depends on MALI_MIDGARD
    default y
    help
      Enables tracing in kbase.  Trace log available through
      the "mali_trace" debugfs file, when the CONFIG_DEBUG_FS is enabled

config MALI_DEBUG_SYS
    bool "Enable sysfs for the Mali Midgard DDK "
    depends on MALI_MIDGARD && SYSFS
    default n
    help
      Enables sysfs for the Mali Midgard DDK. Set/Monitor the Mali Midgard DDK

config MALI_SEC_CL_BOOST
    bool "Enable EXYNOS cl booster"
    depends on MALI_MIDGARD
    default n
    help
      Enables open cl dvfs booster.

config MALI_PM_QOS
    bool "Enable DVFS with QoS"
    depends on MALI_MIDGARD && MALI_DVFS && PM_DEVFREQ && CPU_FREQ && EXYNOS_PM_QOS
    default n
    help
      Choose this option to enable PM_QOS in the Mali tBEx DDK.

config MALI_DEBUG_KERNEL_SYSFS
    bool "Support Kernel Group Debug SysFS"
    depends on MALI_MIDGARD && MALI_DEBUG_SYS
    default n
    help
		Support Support Kernel Group Debug SysFS on /sys/kernel/gpu

config MALI_ASV_CALIBRATION_SUPPORT
	bool "Enable GPU ASV AUTO CALIBRATION"
	depends on MALI_MIDGARD && MALI_RT_PM && MALI_DVFS && VDD_AUTO_CAL
	default n
	help
	  Choose this option to enable AUTO_CALIBRATION_SUPPORT in the Mali tBEx DDK.

config MALI_SEC_VK_BOOST
	bool "Enable GPU VK JOB PMQOS BOOST"
	default n
	help
	  Choose this option to enable VK JOB PMQOS BOOST in the Mali tBEx DDK.

config MALI_SEC_NEGATIVE_BOOST
	bool "Enable GPU NEGATIVE BOOST"
	depends on MALI_DVFS
	default n
	help
	  Choose this option to enable NEGATIVE BOOST in the Mali tBEx DDK.

config MALI_SEC_JOB_STATUS_CHECK
	bool "Enable GPU JOB & FENCE STATUS DUMP"
	depends on MALI_MIDGARD && MALI_RT_PM && MALI_DVFS && (SYNC || SYNC_FILE)
	default n
	help
		Choose this option to enable job & fence status dump feature in the Mali tBEx DDK.

config MALI_FTRACE_FREQ
	bool "Enable ftrace for gpu frequency"
	depends on MALI_MIDGARD && MALI_DVFS
	default n
	help
		Choose this option to enable ftrace for gpu frequency

config MALI_IFPO
	bool "Enable IFPO(Inter-Frame Power Off)"
	depends on MALI_MIDGARD && MALI_RT_PM && MALI_DVFS
	default n
	help
		choose this option to enable IFPO Option in the Mali tBEx DDK.

config MALI_DYNAMIC_IFPO
	bool "Enable Dynamic IFPO Option"
	depends on MALI_MIDGARD && MALI_RT_PM && MALI_DVFS && MALI_IFPO
	default n
	help
		Choose this option to enable dynamic IFPO Option to set threshold value to control ifpo in the Mali tBEx DDK.

config MALI_DELAYED_IFPO_ON_RESUME
	bool "Delay IFPO on wake-up from sleep"
	depends on MALI_MIDGARD && MALI_RT_PM && MALI_DVFS && MALI_IFPO
	default y
	help
		choose this option to delay IFPO enable after wake up from sleep.

config MALI_TSG
	bool "Enable Sustainable optimize"
	depends on MALI_MIDGARD && MALI_RT_PM && MALI_DVFS
	default n
	help
		Choose this option to enable integrated samsung governor in the Mali tBEx DDK.

config MALI_COHERENCY
	bool "Enable coherent mode"
	depends on MALI_MIDGARD
	default n
	help
		Choose this option to enable coherent mode.
		Set coherency features to support ACE & ACE_LITE.
		If you want to use coherent mode, you should add to system-coherency value in dts.

config MALI_NOTIFY_UTILISATION
	bool "Added frag utilisation notifier"
	depends on MALI_MIDGARD
	default y
	help
		Get Fragment Utilisation.

config MALI_USES_LLC
	bool "Enable LLC for Mali"
	depends on MALI_MIDGARD && EXYNOS_SCI
	default n
	help
		Use LLC when above certain gpu frequency

config MALI_CL_PMQOS
	bool "Enable CL PMQOS Table Option"
	depends on MALI_MIDGARD && MALI_RT_PM && MALI_DVFS && MALI_PM_QOS
	default y
	help
		Choose this option to enable CL PMOQS Table Option to set threshold value to control ifpo in the Mali tBEx DDK.

config MALI_JD_RINGBUFFER
	bool "Use ringbuffer scheme for job_done"
	depends on MALI_MIDGARD && MALI_EXPERT
	default n
	help
	  Select this option to use ringbuffer scheme for job_done

config MALI_SEC_POWEROFF_DELAY_WQ
	bool "Enable to change poweroff dealy wa"
	depends on MALI_MIDGARD && MALI_RT_PM && MALI_DVFS
	default y
	help
		Support to change power off delay at specific scenario

config MALI_EXYNOS_SECURE_RENDERING_LEGACY
    bool "Mali Secure Rendering Legacy"
    depends on MALI_MIDGARD && ION_EXYNOS && EXYNOS_CONTENT_PATH_PROTECTION
	default n
    help
      Support Secure Rendering on Exynos SoC (Legacy)

config MALI_EXYNOS_SECURE_RENDERING_ARM
    bool "Mali Secure Rendering Modified ARM"
    depends on MALI_MIDGARD && ION_EXYNOS && EXYNOS_CONTENT_PATH_PROTECTION
	default n
    help
      Support Secure Rendering on Exynos SoC (Newer ARM method)

config MALI_RESET_DOWNSTAY_COUNT
	bool "Config whether to reset downstay count in dvfs timer control"
	depends on MALI_MIDGARD && MALI_RT_PM && MALI_DVFS
	default n
	help
		Resettimg downstay count in dvfs_timer_control function makes the clock doesn't fall in certain situation.
		Do not reset downstay count from Olympus and after that. So Olympus and after, this value becomes n.
```

## drivers/gpu/arm/v_r24p0/platform/exynos/Kconfig
```kconfig
#
# (C) COPYRIGHT 2012 ARM Limited. All rights reserved.
#
# This program is free software and is provided to you under the terms of the
# GNU General Public License version 2 as published by the Free Software
# Foundation, and any use by you of this program is subject to the terms
# of such GNU licence.
#
# A copy of the licence is included with the program, and can also be obtained
# from Free Software Foundation, Inc., 51 Franklin Street, Fifth Floor,
# Boston, MA  02110-1301, USA.
#
#




# Add your platform specific Kconfig file here
#
# "drivers/gpu/arm/.../platform/Kconfig"
#
# Where xxx is the platform name is the name set in MALI_PLATFORM_THIRDPARTY_NAME
#
config EXYNOS_SOC_NAME
    depends on MALI_MIDGARD
    string "Third party soc name"
    help
      soc name.

config MALI_DVFS
    bool "Enable EXYNOS DVFS"
    depends on MALI_MIDGARD
    default n
    help
      Choose this option to enable DVFS in the Mali Midgard DDK.

config MALI_FG_DVFS
    bool "Enable EXYNOS DVFS"
    depends on MALI_MIDGARD
    depends on CAL_IF
    depends on MALI_DVFS
    default y
    help
      Choose this option use Fine Grain CAL IF for Mali DVFS.

config MALI_RT_PM
    bool "Enable EXYNOS Runtime power management"
    depends on MALI_MIDGARD
    depends on PM
    depends on EXYNOS_PD
    default n
    help
      Choose this option to enable runtime power management in the Mali Midgard DDK.

config MALI_EXYNOS_TRACE
    bool "Enable EXYNOS kbase tracing"
    depends on MALI_MIDGARD && DEBUG_FS
    default y
    help
      Enables tracing in kbase.  Trace log available through
      the "mali_trace" debugfs file, when the CONFIG_DEBUG_FS is enabled

config MALI_DEBUG_SYS
    bool "Enable sysfs for the Mali Midgard DDK "
    depends on MALI_MIDGARD && SYSFS
    default n
    help
      Enables sysfs for the Mali Midgard DDK. Set/Monitor the Mali Midgard DDK

config MALI_SEC_CL_BOOST
    bool "Enable EXYNOS cl booster"
    depends on MALI_MIDGARD
    default n
    help
      Enables open cl dvfs booster.

config MALI_PM_QOS
    bool "Enable DVFS with QoS"
    depends on MALI_MIDGARD && MALI_DVFS && PM_DEVFREQ && CPU_FREQ && EXYNOS_PM_QOS
    default n
    help
      Choose this option to enable PM_QOS in the Mali tBEx DDK.

config MALI_DEBUG_KERNEL_SYSFS
    bool "Support Kernel Group Debug SysFS"
    depends on MALI_MIDGARD && MALI_DEBUG_SYS
    default n
    help
		Support Support Kernel Group Debug SysFS on /sys/kernel/gpu

config MALI_EXYNOS_SECURE_RENDERING
    bool "Enable EXYNOS Secure Rendering Support"
    depends on MALI_MIDGARD && ION_EXYNOS && EXYNOS_CONTENT_PATH_PROTECTION
    default n
    help
      Support Secure Rendering on Exynos SoC

config MALI_ASV_CALIBRATION_SUPPORT
	bool "Enable GPU ASV AUTO CALIBRATION"
	depends on MALI_MIDGARD && MALI_RT_PM && MALI_DVFS && VDD_AUTO_CAL
	default n
	help
	  Choose this option to enable AUTO_CALIBRATION_SUPPORT in the Mali tBEx DDK.

config MALI_SEC_VK_BOOST
	bool "Enable GPU VK JOB PMQOS BOOST"
	default n
	help
	  Choose this option to enable VK JOB PMQOS BOOST in the Mali tBEx DDK.

config MALI_SEC_NEGATIVE_BOOST
	bool "Enable GPU NEGATIVE BOOST"
	depends on MALI_DVFS
	default n
	help
	  Choose this option to enable NEGATIVE BOOST in the Mali tBEx DDK.

config MALI_SEC_JOB_STATUS_CHECK
	bool "Enable GPU JOB & FENCE STATUS DUMP"
	depends on MALI_MIDGARD && MALI_RT_PM && MALI_DVFS && (SYNC || SYNC_FILE)
	default n
	help
		Choose this option to enable job & fence status dump feature in the Mali tBEx DDK.

config MALI_SUSTAINABLE_OPT
	bool "Enable Sustainable optimize"
	depends on MALI_MIDGARD && MALI_RT_PM && MALI_DVFS
	default n
	help
		Choose this option to enable sustainable optimization in the Mali tBEx DDK.

config MALI_FTRACE_FREQ
	bool "Enable ftrace for gpu frequency"
	depends on MALI_MIDGARD && MALI_DVFS
	default n
	help
		Choose this option to enable ftrace for gpu frequency

config MALI_IFPO
	bool "Enable IFPO(Inter-Frame Power Off)"
	depends on MALI_MIDGARD && MALI_RT_PM && MALI_DVFS
	default n
	help
		choose this option to enable IFPO Option in the Mali tBEx DDK.

config MALI_DYNAMIC_IFPO
	bool "Enable Dynamic IFPO Option"
	depends on MALI_MIDGARD && MALI_RT_PM && MALI_DVFS && MALI_IFPO
	default n
	help
		Choose this option to enable dynamic IFPO Option to set threshold value to control ifpo in the Mali tBEx DDK.

config MALI_TSG
	bool "Enable Sustainable optimize"
	depends on MALI_MIDGARD && MALI_RT_PM && MALI_DVFS
	default n
	help
		Choose this option to enable integrated samsung governor in the Mali tBEx DDK.

config MALI_COHERENCY
	bool "Enable coherent mode"
	depends on MALI_MIDGARD
	default n
	help
		Choose this option to enable coherent mode.
		Set coherency features to support ACE & ACE_LITE.
		If you want to use coherent mode, you should add to system-coherency value in dts.

config MALI_NOTIFY_UTILISATION
	bool "Added frag utilisation notifier"
	depends on MALI_MIDGARD
	default y
	help
		Get Fragment Utilisation.

config MALI_USES_LLC
	bool "Enable LLC for Mali"
	depends on MALI_MIDGARD && EXYNOS_SCI
	default n
	help
		Use LLC when above certain gpu frequency

config MALI_CL_PMQOS
	bool "Enable CL PMQOS Table Option"
	depends on MALI_MIDGARD && MALI_RT_PM && MALI_DVFS && MALI_PM_QOS
	default y
	help
		Choose this option to enable CL PMOQS Table Option to set threshold value to control ifpo in the Mali tBEx DDK.
```

## drivers/gud/Kconfig
```kconfig
#
# Mobicore Configuration
#
if SOC_EXYNOS2100
source "drivers/gud/gud-exynos2100/Kconfig"
endif
if SOC_EXYNOS991
source "drivers/gud/gud-exynos991/Kconfig"
endif
```

## drivers/gud/gud-exynos2100/Kconfig
```kconfig
#
# Trustonic drivers configuration
#
config TRUSTONIC_TEE
    tristate "Trustonic TEE Driver"
    depends on ARM || ARM64
    default m
    ---help---
      Enable Trustonic TEE support

config TRUSTONIC_TEE_DEBUG
    bool "Trustonic TEE driver debug mode"
    depends on TRUSTONIC_TEE
    default n
    ---help---
      Enable the debug mode in the Trustonic TEE Driver.

config TRUSTONIC_TRUSTED_UI
    tristate "Trustonic Trusted UI"
    depends on TRUSTONIC_TEE
    default m
    ---help---
      Enable Trustonic Trusted User Interface

config TRUSTONIC_TRUSTED_UI_FB_BLANK
    bool "Trustonic Trusted UI with fb_blank"
    depends on TRUSTONIC_TRUSTED_UI
    default y
    ---help---
    Blank the framebuffer before starting a TUI session

#ExySp
source "drivers/gud/gud-exynos2100/sec-os-ctrl/Kconfig"
source "drivers/gud/gud-exynos2100/sec-os-booster/Kconfig"
```

## drivers/input/input_boost/Kconfig
```kconfig
config SEC_INPUT_BOOSTER
	tristate "SEC INPUT BOOSTER"
	depends on INPUT_EVDEV
	default n
	help
	  Say Y here if you enable input boosting for various input device
	  such as touch.

	  Say N here if you disable input boosting.

	  If unsure, say Y.

config SEC_INPUT_BOOSTER_MODE
	bool "SEC INPUT BOOSTER MODE"
	depends on SEC_INPUT_BOOSTER
	default n
	help
	  Say Y here if you enable input boosting mode for various scenarios
	  where needed to disable or change input booster.

	  Say N here if you disable input booster mode
	  which means DVFS file will be used in this model for handling scenarios.

	  If unsure, say N.

config SEC_INPUT_BOOSTER_QC
	bool "SEC INPUT BOOSTER QC"
	depends on SEC_INPUT_BOOSTER
	default n
	help
	  Say Y here if you enable input boosting of QC under QC chipset

	  Say N here if you disable input boosting of QC

	  If unsure, say N.

config SEC_INPUT_BOOSTER_SLSI
	bool "SEC INPUT BOOSTER SLSI"
	depends on SEC_INPUT_BOOSTER
	default n
	help
	  Say Y here if you enable input boosting of SLSI under SLSI chipset
	  such as touch.

	  Say N here if you disable input boosting of SLSI

	  If unsure, say N.

config SEC_INPUT_BOOSTER_MTK
	bool "SEC INPUT BOOSTER MTK"
	depends on SEC_INPUT_BOOSTER
	default n
	help
	  Say Y here if you enable input boosting of MTK under MTK chipset
	  such as touch.

	  Say N here if you disable input boosting of MTK

	  If unsure, say N.


config SEC_INPUT_BOOSTER_HANDLER
	bool "SEC INPUT BOOSTER HANDLER"
	depends on SEC_INPUT_BOOSTER
	default n
	help
	  Say Y here if you enable input_handler

	  Say N here if you use legacy evdev.c event

	  If unsure, say N.
```

## drivers/input/sec_input/Kconfig
```kconfig
# SPDX-License-Identifier: GPL-2.0-only
#
# SEC Input device configuration
#

config INPUT_SEC_INPUT
	tristate "Support for SEC input layer"
	help
	  Say Y here if you want to use sec cmd.

config SEC_DEBUG_TSP_LOG
	tristate "Support for tsp_msg"
	help
	  Say Y here if you want to use tsp_msg node.

config INPUT_TOUCHSCREEN_TCLMV2
	tristate "touchscreen tclmv2"
	help
	  Say Y here if you want to use tclm.

config INPUT_SEC_SECURE_TOUCH
	tristate "input sec secure touch"
	depends on INPUT
	help
	  Say Y here if you need to use sec secure touch.

config TOUCHSCREEN_DUMP_MODE
	tristate "touchscreen dump mode"
	help
	  Say Y here if you need to get raw data.

config INPUT_SEC_NOTIFIER
	tristate "input sec notifier"
	help
	  Say Y here if you need to use input notifier.

config TOUCHSCREEN_DUAL_FOLDABLE
	tristate "Dual TSP IC for Foldable"
	help
	  Say Y here if you need to use dual tsp.

config SEC_INPUT_CMD_TEST
	tristate "KUnit test for tsp_common_test"
	depends on SEC_KUNIT
	help
	  TODO: Describe config fully.
```
