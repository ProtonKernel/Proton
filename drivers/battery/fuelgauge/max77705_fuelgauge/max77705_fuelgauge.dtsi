&smd {
	max77705_fuelgauge: max77705-fuelgauge {
			    /* for 4500mAh battery */
			    status = "okay";
			    fuelgauge,fuel_alert_soc = <1>;
			    fuelgauge,jig_gpio = <SEC_GPIO_REF(AP,gpm15,0) 0>; /* IFC_SENSE_INT_AP */
			    fuelgauge,jig_low_active;
			    fuelgauge,capacity_max = <1000>;
			    fuelgauge,capacity_max_margin = <300>;
			    fuelgauge,capacity_min = <0>;
			    fuelgauge,capacity_calculation_type = <28>;
			    fuelgauge,repeated_fuelalert;
			    fuelgauge,using_temp_compensation;
			    fuelgauge,low_temp_limit = <100>;
			    fuelgauge,vempty_recover_time = <180>; /* 3 mins */
			    fuelgauge,using_hw_vempty;
			    fuelgauge,sw_v_empty_voltage = <3200>;
			    fuelgauge,sw_v_empty_voltage_cisd = <3100>;
			    fuelgauge,sw_v_empty_recover_voltage = <3480>;
			    fuelgauge,fg_resistor = <2>;
#if 1
			    fuelgauge,bat_id_gpio = <
#if 0
					SEC_GPIO_REF(${bat_id_gpio_2}) 0 /* BAT_ID_GPIO 1 */
#endif
					SEC_GPIO_REF(AP,gpg2,2) 0 /* BAT_ID_GPIO 0 */
					>;
#endif
#if 0
			    fuelgauge,sub_bat_id_gpio = <SEC_GPIO_REF(${sub_bat_id_gpio}) 0>; /* SUB_BAT_ID */
#endif
			    battery_params {
				/* battery0 : default */
				battery0,v_empty = <0xA7E2>; /* Empty: 3350mV, Recover: 3920mV */
				battery0,v_empty_origin = <0x7D54>; /* Empty: 2500mV, Recover: 3360mV */
				battery0,capacity = <0x0FEF>;
				/* fullcapnom(=capacity), dPacc, dQacc,  rcomp0, tempco */
				battery0,fg_reset_wa_data = <0x0FEF 0x3200 0x03FB 0x003A 0x2534>;

				/* battery1 */
				battery1,v_empty = <0xA7E2>; /* Empty: 3350mV, Recover: 3920mV */
				battery1,v_empty_origin = <0x7D54>; /* Empty: 2500mV, Recover: 3360mV */
				battery1,capacity = <0x0FFF>;
				/* fullcapnom(=capacity), dPacc, dQacc,  rcomp0, tempco */
				battery1,fg_reset_wa_data = <0x0FFF 0x3200 0x03FB 0x003A 0x2534>;
			    };
		    };
};

/* /home/dpi/qb5_8814/workspace/P4_1716/android/kernel/kmodule/battery/fuelgauge/max77705_fuelgauge_gki/max77705_fuelgauge.r9s.dtsi */
&max77705_fuelgauge {
	fuelgauge,capacity_calculation_type = <0x5C>;
	fuelgauge,lost_soc_trig_soc = <1000>; /* 100.0% */
	fuelgauge,lost_soc_trig_d_soc = <20>; /* 2% */
	fuelgauge,lost_soc_trig_scale = <2>; /* 2x */
	fuelgauge,lost_soc_guarantee_soc = <30>; /* 3.0% */
	fuelgauge,lost_soc_min_vol = <3200>; /* 3200mV */

	battery_params {
		/* battery0: LOW (LGES) */
		battery0,v_empty = <0xAA64>; /* Empty: 3400mV, Recover: 4000mV */
		battery0,v_empty_origin = <0x7D54>; /* Empty: 2500mV, Recover: 3360mV */
		battery0,capacity = <0x0FEC>;
					/* fullcapnom dPacc dQacc RCOMP0 TempCo */
		battery0,fg_reset_wa_data = <0x0FEC 0x3200 0x03FB 0x0036 0x1C25>;

		/* battery1: OPEN (SDI) */
		battery1,v_empty = <0xAA64>; /* Empty: 3400mV, Recover: 4000mV */
		battery1,v_empty_origin = <0x7D54>; /* Empty: 2500mV, Recover: 3360mV */
		battery1,capacity = <0x1024>;
					/* fullcapnom dPacc dQacc RCOMP0 TempCo */
		battery1,fg_reset_wa_data = <0x1024 0x3200 0x0409 0x002D 0x131F>;

		battery0,data_ver = <0x3>;
		battery1,data_ver = <0x4>;

		battery0,selected_reg = <
			0x02 0x7F80	/* default */
			0x12 0x4500	/* QResidual00 */
			0x1E 0x0830	/* ICHGTerm */
			0x21 0x6200	/* default */
			0x22 0x1F80	/* QResidual10 */
			0x2A 0x043C	/* RelaxCFG */
			0x2C 0xE3E1	/* TGAIN */
			0x2D 0x290E	/* TOFF */
			0x2E 0x0400	/* CGAIN */
			0x2F 0x0001	/* COFF */
			0x32 0x0C80	/* QResidual20 */
			0x33 0xFFFF	/* default */
			0x37 0x05E0	/* default */
			0x42 0x0B00	/* QResidual30 */
			0xB4 0x7F80	/* default */
			0xB8 0x0000	/* default */
			0xB9 0x006B	/* default */
			0xBA 0x090C	/* default */
			>;

		battery1,selected_reg = <
			0x02 0x7F80	/* default */
			0x12 0x5D00	/* QResidual00 */
			0x1E 0x0830	/* ICHGTerm */
			0x21 0x6200	/* default */
			0x22 0x2680	/* QResidual10 */
			0x2A 0x043C	/* RelaxCFG */
			0x2C 0xE3E1	/* TGAIN */
			0x2D 0x290E	/* TOFF */
			0x2E 0x0400	/* CGAIN */
			0x2F 0x0001	/* COFF */
			0x32 0x0B00	/* QResidual20 */
			0x33 0xFFFF	/* default */
			0x37 0x05E0	/* default */
			0x42 0x0900	/* QResidual30 */
			0xB4 0x7F80	/* default */
			0xB8 0x0000	/* default */
			0xB9 0x006B	/* default */
			0xBA 0x090C	/* default */
			>;
	};
};
