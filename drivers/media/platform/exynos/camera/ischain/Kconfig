## drivers/media/platform/exynos/camera/vendor/mcd/Kconfig
```kconfig
config CAMERA_EEPROM_SUPPORT_REAR
        tristate "Enable eeprom for rear cam"
        depends on CAMERA_VENDER_MCD
        default n
        help
          Enable eeprom for rear cam.
config CAMERA_OTPROM_SUPPORT_REAR
        tristate "Enable otprom for rear cam"
        depends on CAMERA_VENDER_MCD
        default n
        help
          Enable otprom for rear cam.
config CAMERA_EEPROM_SUPPORT_FRONT
        tristate "Enable eeprom for front cam"
        depends on CAMERA_VENDER_MCD
        default n
        help
          Enable eeprom for front cam.
config COMPANION_DCDC_USE
        bool "Use companion DCDC regulator"
        depends on CAMERA_VENDER_MCD
        default n
        help
          Use companion DCDC regulator.
config SENSOR_RETENTION_USE
        bool "Use sensor retention"
        depends on CAMERA_VENDER_MCD
        default n
        help
          Use sensor retention.
config OIS_USE
        bool "Use ois"
        depends on CAMERA_VENDER_MCD
        default n
        help
          Use ois.
config OIS_FW_UPDATE_THREAD_USE
        bool "Enable ois fw update thread"
        depends on OIS_USE
        default n
        help
          Enable ois fw update thread.
config AF_HOST_CONTROL
        bool "Enable host af control"
        depends on CAMERA_VENDER_MCD
        default n
        help
          Enable host af control.
config TORCH_CURRENT_CHANGE_SUPPORT
        bool "Change torch current in recording mode"
        depends on CAMERA_VENDER_MCD
        default n
        help
          Change torch current in recording mode.
config FLASH_CURRENT_CHANGE_SUPPORT
        bool "Change flash current in capturing image"
        depends on CAMERA_VENDER_MCD
        default n
        help
           Change torch current in capturing image.
config SECURE_CAMERA_USE
        tristate "Use secure camera"
        depends on CAMERA_VENDER_MCD
        default n
        help
          Use secure camera.
config USE_SIGNED_BINARY
        bool "Enable signed binary processing."
        depends on CAMERA_VENDER_MCD
        default n
        help
          Enable signed binary processing.
config USE_CAMERA_LDU
        bool "Use Camera LDU"
        depends on CAMERA_VENDER_MCD
        default n
        help
          Use Camera LDU.
config CAMERA_CIS_TOF_BUCK_USE
        bool "Use isl91128 for tof"
        depends on CAMERA_VENDER_MCD
        default n
        help
          Use isl91128.
config CAMERA_USE_MCU
        bool "Use Camera mcu"
        depends on CAMERA_VENDER_MCD
        default n
        help
          Use Camera MCU.
config SENSORCORE_MCU_CONTROL
        bool "Use sensor core mcu control"
        depends on CAMERA_VENDER_MCD
        default n
        help
          Use sensor control mcu.
config CAMERA_USE_INTERNAL_MCU
        bool "Use internal MCU for OIS"
        depends on CAMERA_VENDER_MCD
        default n
        help
          Use internal MCU for OIS.
config CAMERA_USU_V01
        bool "This camera is usu_v01"
        depends on CAMERA_VENDER_MCD
        default n
        help
          This camera is usu_v01.
config CAMERA_USU_V02
        bool "This camera is usu_v02"
        depends on CAMERA_VENDER_MCD
        default n
        help
          This camera is usu_v02.
config CAMERA_USU_V03
        bool "This camera is usu_v03"
        depends on CAMERA_VENDER_MCD
        default n
        help
          This camera is usu_v03.
config CAMERA_RSU_V09
        bool "This camera is rsu_v09"
        depends on CAMERA_VENDER_MCD
        default n
        help
          This camera is rsu_v09.
config USE_OIS_TAMODE_CONTROL
	bool "Use ois TAMODE control"
        depends on CAMERA_VENDER_MCD
        default n
        help
          Use ois TAMODE control.
```

## drivers/media/platform/exynos/mcfrc/Kconfig
```kconfig
#
# Exynos multimedia device drivers
#
config VIDEO_EXYNOS_MC_FRC
        tristate "Exynos MC FRC driver"
        depends on VIDEO_EXYNOS
        depends on m
        default m
        help
          This is a representative exynos MC FRC device
```

## drivers/media/platform/exynos/repeater/Kconfig
```kconfig
config VIDEO_EXYNOS_REPEATER
       tristate "EXYNOS REPEATER Driver"
       depends on VIDEO_EXYNOS
       default n
	---help---
	  Repeater driver for WFD
```

## drivers/media/platform/exynos/tsmux/Kconfig
```kconfig
#
# Exynos tsmux device driver
#

config VIDEO_EXYNOS_TSMUX
	tristate "EXYNOS TSMUX Driver"
	depends on VIDEO_EXYNOS
	default n
	---help---
	  Tsmux driver for WFD
```

## drivers/mfd/maxim/Kconfig
```kconfig
config MFD_MAX77705
	tristate "Maxim Semiconductor MAX77705 PMIC Support"
	depends on I2C=y
	select MFD_CORE
	help
	  Say yes here to support for Maxim Semiconductor MAX77705.
	  This is a Power Management IC with Charger, safe LDOs, Flash, Haptic
	  and MUIC controls on chip.
	  This driver provides common support for accessing the device;
	  additional drivers

config QCOM_IFPMIC_SUSPEND
	tristate "QCOM_IFPMIC_SUSPEND Function Support"
	default n
	help
	  If you say yes here you will get support for
	  QCOM_IFPMIC_SUSPEND function

config ABC_IFPMIC_EVENT
	bool "Using EVENT SENDING TO ABC MODULE"
	depends on I2C=y
	default n
	help
	  If you say yes here you will not get support for the sending event to abc module.

config MAX77705_FW_SEPARATION_PID_BY_MODEL
	bool "Separate of pid by model"
	depends on CCIC_MAX77705
	default n
	help
	  If you want to use specific firmware by model,
	  this feature must be enabled.
	  Each models will have own firmware pid.
	  MAX77705_FW_PID03_SUPPORT feature in usbc is ignored.

config MAX77705_USE_EXTRA_FW
	bool "Use extra firmware"
	depends on CCIC_MAX77705
	default n
	help
	  If you want to use extra firmware for specific hw id,
	  this feature must be enabled.
	  The specific hw board only use extra firmware.
	  That board cannot update normal version firmware.
```

## drivers/net/dropdump/Kconfig
```kconfig
#
# net: logging dropped skb
#

comment "Enable Dropdump to logging dropped network packet"

config SUPPORT_DROPDUMP
	tristate "Network packet drop logging service for tcpdump"
```
