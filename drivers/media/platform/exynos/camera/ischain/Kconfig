## drivers/media/platform/exynos/camera/sensor/module_framework/cis/Kconfig
```kconfig
menuconfig CAMERA_CIS_SELECT
	bool "CIS select"
	depends on EXYNOS_DEVICE_CAMERA_MODULE
	help
	  Say Y here to enable support for platform-specific V4L drivers.

config CAMERA_CIS_6B2_OBJ
	tristate "Use 6B2 camera cis"
	depends on CAMERA_CIS_SELECT
	default n
	help
	  Use to build 6B2 camera sensor.

config CAMERA_CIS_5E2_OBJ
	tristate "Use 5E2 camera cis"
	depends on CAMERA_CIS_SELECT
	default n
	help
	  Use to build 5E2 camera sensor.

config CAMERA_CIS_5E3_OBJ
	tristate "Use 5E3 camera cis"
	depends on CAMERA_CIS_SELECT
	default n
	help
	  Use to build 5E3 camera sensor.

config CAMERA_CIS_4H5YC_OBJ
	tristate "Use 4H5YC camera cis"
	depends on CAMERA_CIS_SELECT
	default n
	help
	  Use to build 4H5YC camera sensor.

config CAMERA_CIS_4H5_OBJ
	tristate "Use 4H5 camera cis"
	depends on CAMERA_CIS_SELECT
	default n
	help
	  Use to build 4H5 camera sensor.

config CAMERA_CIS_2P2_OBJ
	tristate "Use 2P2 camera cis"
	depends on CAMERA_CIS_SELECT
	default n
	help
	  Use to build 2P2 camera sensor.

config CAMERA_CIS_2P6_OBJ
	tristate "Use 2P6 camera cis"
	depends on CAMERA_CIS_SELECT
	default n
	help
	  Use to build 2P6 camera sensor.

config CAMERA_CIS_2P8_OBJ
	tristate "Use 2P8 camera cis"
	depends on CAMERA_CIS_SELECT
	default n
	help
	  Use to build 2P8 camera sensor.

config CAMERA_CIS_2X5_OBJ
	tristate "Use 2X5 camera cis"
	depends on CAMERA_CIS_SELECT
	default n
	help
	  Use to build 2X5 camera sensor.

config CAMERA_CIS_3P3_OBJ
	tristate "Use 3P3 camera cis"
	depends on CAMERA_CIS_SELECT
	default n
	help
	  Use to build 3P3 camera sensor.

config CAMERA_CIS_3L2_OBJ
	tristate "Use 3L2 camera cis"
	depends on CAMERA_CIS_SELECT
	default n
	help
	  Use to build 3L2 camera sensor.

config CAMERA_CIS_3H1_OBJ
	tristate "Use 3H1 camera cis"
	depends on CAMERA_CIS_SELECT
	default n
	help
	  Use to build 3H1 camera sensor.

config CAMERA_CIS_3H1_C3_OBJ
	tristate "Use 3H1 camera cis for companion"
	depends on CAMERA_CIS_SELECT
	default n
	help
	  Use to build 3H1 camera sensor.

config CAMERA_CIS_3J1_OBJ
	tristate "Use 3J1 camera cis"
	depends on CAMERA_CIS_SELECT
	default n
	help
	  Use to build 3J1 camera sensor.

config CAMERA_CIS_4E6_OBJ
	tristate "Use 4E6 camera cis"
	depends on CAMERA_CIS_SELECT
	default n
	help
	  Use to build 4E6 camera sensor.

config CAMERA_CIS_5E6_OBJ
	tristate "Use 5E6 camera cis"
	depends on CAMERA_CIS_SELECT
	default n
	help
	  Use to build 5E6 camera sensor.

config CAMERA_CIS_5F1_OBJ
	tristate "Use 5F1 camera cis"
	depends on CAMERA_CIS_SELECT
	default n
	help
	  Use to build 5F1 camera sensor.

config CAMERA_CIS_3M2_OBJ
	tristate "Use 3M2 camera cis"
	depends on CAMERA_CIS_SELECT
	default n
	help
	  Use to build 3M2 camera sensor.

config CAMERA_CIS_3M3_OBJ
	tristate "Use 3M3 camera cis"
	depends on CAMERA_CIS_SELECT
	default n
	help
	  Use to build 3M3 camera sensor.

config CAMERA_CIS_3M5_OBJ
	tristate "Use 3M5 camera cis"
	depends on CAMERA_CIS_SELECT
	default n
	help
	  Use to build 3M5 camera sensor.

config CAMERA_CIS_GH1_OBJ
	tristate "Use GH1 camera cis"
	depends on CAMERA_CIS_SELECT
	default n
	help
	  Use to build GH1 camera sensor.

config CAMERA_CIS_GW2_OBJ
	tristate "Use GW2 camera cis"
	depends on CAMERA_CIS_SELECT
	default n
	help
	  Use to build GW2 camera sensor.

config CAMERA_CIS_HI847_OBJ
	tristate "Use HI847 camera cis"
	depends on CAMERA_CIS_SELECT
	default n
	help
	  Use to build HI847 camera sensor.

config CAMERA_CIS_2L1_OBJ
	tristate "Use 2L1 camera cis"
	depends on CAMERA_CIS_SELECT
	default n
	help
	  Use to build 2L1 camera sensor.

config CAMERA_CIS_3P8_OBJ
	tristate "Use 3P8 camera cis"
	depends on CAMERA_CIS_SELECT
	default n
	help
	  Use to build 3P8 camera sensor.

config CAMERA_CIS_3P9_OBJ
	tristate "Use 3P9 camera cis"
	depends on CAMERA_CIS_SELECT
	default n
	help
	  Use to build 3P9 camera sensor.

config CAMERA_CIS_3P8SP_OBJ
	tristate "Use 3P8SP camera cis"
	depends on CAMERA_CIS_SELECT
	default n
	help
	  Use to build 3P8SP camera sensor.

config CAMERA_CIS_2P7SX_OBJ
	tristate "Use 2P7SX camera cis"
	depends on CAMERA_CIS_SELECT
	default n
	help
	  Use to build 2P7SX camera sensor.

config CAMERA_CIS_RPB_OBJ
	tristate "Use RPB camera cis"
	depends on CAMERA_CIS_SELECT
	default n
	help
	  Use to build RPB camera sensor.

config CAMERA_CIS_2P7SQ_OBJ
	tristate "Use 2P7SQ camera cis"
	depends on CAMERA_CIS_SELECT
	default n
	help
	  Use to build 2P7SQ camera sensor.

config CAMERA_CIS_2T7SX_OBJ
	tristate "Use 2T7SX camera cis"
	depends on CAMERA_CIS_SELECT
	default n
	help
	  Use to build 2T7SX camera sensor.

config CAMERA_CIS_2L2_OBJ
	tristate "Use 2L2 camera cis"
	depends on CAMERA_CIS_SELECT
	default n
	help
	  Use to build 2L2 camera sensor.

config CAMERA_CIS_2L3_OBJ
	tristate "Use 2L3 camera cis"
	depends on CAMERA_CIS_SELECT
	default n
	help
	  Use to build 2L3 camera sensor.

config CAMERA_CIS_2L4_OBJ
	tristate "Use 2L4 camera cis"
	depends on CAMERA_CIS_SELECT
	default n
	help
	  Use to build 2L4 camera sensor.

config CAMERA_CIS_2LA_OBJ
	tristate "Use 2LA camera cis"
	depends on CAMERA_CIS_SELECT
	default n
	help
	  Use to build 2LA camera sensor.

config CAMERA_CIS_2LD_OBJ
	tristate "Use 2LD camera cis"
	depends on CAMERA_CIS_SELECT
	default n
	help
	  Use to build 2LD camera sensor.

config CAMERA_CIS_HM1_OBJ
	tristate "Use HM1 camera cis"
	depends on CAMERA_CIS_SELECT
	default n
	help
	  Use to build HM1 camera sensor.

config CAMERA_CIS_HM3_OBJ
	tristate "Use HM3 camera cis"
	depends on CAMERA_CIS_SELECT
	default n
	help
	  Use to build HM3 camera sensor.

config CAMERA_CIS_IMX260_OBJ
	tristate "Use IMX260 camera cis"
	depends on CAMERA_CIS_SELECT
	default n
	help
	  Use to build IMX260 camera sensor.

config CAMERA_CIS_IMX333_OBJ
	tristate "Use IMX333 camera cis"
	depends on CAMERA_CIS_SELECT
	default n
	help
	  Use to build IMX333 camera sensor.

config CAMERA_CIS_IMX555_OBJ
	tristate "Use IMX555 camera cis"
	depends on CAMERA_CIS_SELECT
	default n
	help
	  Use to build IMX555 camera sensor.

config CAMERA_CIS_2L7_OBJ
	tristate "Use 2L7 camera cis"
	depends on CAMERA_CIS_SELECT
	default n
	help
	  Use to build 2L7 camera sensor.

config CAMERA_CIS_IMX320_OBJ
	tristate "Use IMX320 camera cis"
	depends on CAMERA_CIS_SELECT
	default n
	help
	  Use to build IMX320 camera sensor.

config CAMERA_CIS_IMX320_C3_OBJ
	tristate "Use IMX320_C3 camera cis"
	depends on CAMERA_CIS_SELECT
	default n
	help
	  Use to build IMX320_C3 camera sensor.

config CAMERA_CIS_IMX219_OBJ
	tristate "Use IMX219 camera cis"
	depends on CAMERA_CIS_SELECT
	default n
	help
	  Use to build IMX219 camera sensor.

config CAMERA_CIS_IMX258_OBJ
	tristate "Use IMX258 camera cis"
	depends on CAMERA_CIS_SELECT
	default n
	help
	  Use to build IMX258 camera sensor.

config CAMERA_CIS_IMX241_OBJ
	tristate "Use IMX241 camera cis"
	depends on CAMERA_CIS_SELECT
	default n
	help
	  Use to build IMX241 camera sensor.

config CAMERA_CIS_SR259_OBJ
	tristate "Use SR259 camera cis"
	depends on CAMERA_CIS_SELECT
	default n
	help
	  Use to build SR259 camera sensor.

config CAMERA_CIS_4HA_OBJ
	tristate "Use 4HA camera cis"
	depends on CAMERA_CIS_SELECT
	default n
	help
	  Use to build 4HA camera sensor.

config CAMERA_CIS_IMX563_OBJ
	tristate "Use IMX563 camera cis"
	depends on CAMERA_CIS_SELECT
	default n
	help
	  Use to build IMX563 camera sensor.

config CAMERA_CIS_IMX576_OBJ
	tristate "Use IMX576 camera cis"
	depends on CAMERA_CIS_SELECT
	default n
	help
	  Use to build IMX576 camera sensor.

config CAMERA_CIS_IMX316_OBJ
	tristate "Use IMX316 camera cis"
	depends on CAMERA_CIS_SELECT
	default n
	help
	  Use to build IMX316 camera sensor.

config CAMERA_CIS_IMX516_OBJ
	tristate "Use IMX516 camera cis"
	depends on CAMERA_CIS_SELECT
	default n
	help
	  Use to build IMX516 camera sensor.

config CAMERA_CIS_IMX518_OBJ
	tristate "Use IMX518 camera cis"
	depends on CAMERA_CIS_SELECT
	default n
	help
	  Use to build IMX518 camera sensor.

config CAMERA_CIS_5E9_OBJ
	tristate "Use S5K5E9 camera cis"
	depends on CAMERA_CIS_SELECT
	default n
	help
	  Use to build S5K5E9 camera sensor.

config CAMERA_CIS_GC5035_OBJ
	tristate "Use GC5035 camera cis"
	depends on CAMERA_CIS_SELECT
	default n
	help
	  Use to build GC5035 camera sensor.


config CAMERA_CIS_GM1SP_OBJ
	tristate "Use GM1SP camera cis"
	depends on CAMERA_CIS_SELECT
	default n
	help
	  Use to build GM1SP camera sensor.

config CAMERA_CIS_VIRTUAL_OBJ
	tristate "Use VIRTUAL camera cis"
	depends on CAMERA_CIS_SELECT
		default n
		help
		  Use to build VIRTUAL camera sensor.

config CAMERA_CIS_IMX582_OBJ
	tristate "Use IMX582 camera cis"
	depends on CAMERA_CIS_SELECT
	default n
	help
	  Use to build IMX582 camera sensor.

config CAMERA_CIS_IMX616_OBJ
	tristate "Use IMX616 camera cis"
	depends on CAMERA_CIS_SELECT
	default n
	help
	  Use to build IMX616 camera sensor.

config CAMERA_CIS_GD1_OBJ
	tristate "Use GD1 camera cis"
	depends on CAMERA_CIS_SELECT
	default n
	help
	  Use to build GD1 camera sensor.

config CAMERA_CIS_HI1336_OBJ
	tristate "Use HI1336 camera cis"
	depends on CAMERA_CIS_SELECT
	default n
	help
	  Use to build HI1336 camera sensor.

config CAMERA_CIS_GM2_OBJ
	tristate "Use GM2 camera cis"
	depends on CAMERA_CIS_SELECT
	default n
	help
	  Use to build GM2 camera sensor.

config CAMERA_CIS_IMX586_OBJ
	tristate "Use IMX586 camera cis"
	depends on CAMERA_CIS_SELECT
	default n
	help
	  Use to build IMX586 camera sensor.

config CAMERA_CIS_GW1_OBJ
	tristate "Use GW1 camera cis"
	depends on CAMERA_CIS_SELECT
	default n
	help
	  Use to build GW1 camera sensor.

config CAMERA_CIS_IMX686_OBJ
	tristate "Use IMX686 camera cis"
	depends on CAMERA_CIS_SELECT
	default n
	help
	  Use to build IMX686 camera sensor.

config CAMERA_CIS_GD1_OBJ
	tristate "Use GD1 camera cis"
	depends on CAMERA_CIS_SELECT
	default n
	help
	  Use to build GD1 camera sensor.
```

## drivers/media/platform/exynos/camera/sensor/module_framework/eeprom/Kconfig
```kconfig
menuconfig CAMERA_EEPROM_SELECT
	bool "Sensor eeprom select"
	depends on EXYNOS_DEVICE_CAMERA_MODULE
	help
	  Say Y here to enable support for platform-specific V4L drivers.

config CAMERA_EEPROM_GM1_OBJ
	bool "Use GM1 EEPROM"
	depends on CAMERA_EEPROM_SELECT
	default n
	help
	  Use to build GM1 eeprom driver.

config CAMERA_EEPROM_5E9_OBJ
	bool "Use 5E9 EEPROM"
	depends on CAMERA_EEPROM_SELECT
	default n
	help
	  Use to build 5E9 eeprom driver.
```

## drivers/media/platform/exynos/camera/sensor/module_framework/flash/Kconfig
```kconfig
menuconfig CAMERA_FLASH_SELECT
	bool "Flash select"
	depends on EXYNOS_DEVICE_CAMERA_MODULE
	help
	  Say Y here to enable support for platform-specific V4L drivers.

config CAMERA_FLASH_LM3560_OBJ
	tristate "Use LM3560"
	depends on CAMERA_FLASH_SELECT
	default n
	help
	  Use to build LM3560 driver.

config CAMERA_FLASH_RT5033_OBJ
	tristate "Use RT5033"
	depends on CAMERA_FLASH_SELECT
	default n
	help
	  Use to build RT5033 driver.

config CAMERA_FLASH_S2MPB02_OBJ
	tristate "Use S2MPB02"
	depends on CAMERA_FLASH_SELECT && MFD_S2MPB02
	default n
	help
	  Use to build S2MPB02 driver.

config CAMERA_FLASH_S2MU106_OBJ
	tristate "Use S2MU106"
	depends on CAMERA_FLASH_SELECT
	default n
	help
	  Use to build S2MU106 driver.

config CAMERA_FLASH_S2MU107_OBJ
	tristate "Use S2MU107"
	depends on CAMERA_FLASH_SELECT
	default n
	help
	  Use to build S2MU107 driver.

config CAMERA_FLASH_GPIO_OBJ
	tristate "Use GPIO"
	depends on CAMERA_FLASH_SELECT
	default n
	help
	  Use to build GPIO driver.

config CAMERA_FLASH_I2C_OBJ
	tristate "Use I2C"
	depends on CAMERA_FLASH_SELECT
	default n
	help
	  Use to build I2C driver.

config CAMERA_FLASH_KTD2692_OBJ
	tristate "Use KTD2692"
	depends on CAMERA_FLASH_SELECT
	default n
	help
	  Use to build KTD2692 driver.
```

## drivers/media/platform/exynos/camera/sensor/module_framework/i2c_dummy/Kconfig
```kconfig
menuconfig CAMERA_I2C_DUMMY_SELECT
	bool "I2C DUMMY select"
	depends on EXYNOS_DEVICE_CAMERA_MODULE
	help
		Say Y here to enable support for platform-specific V4L drivers.
```

## drivers/media/platform/exynos/camera/sensor/module_framework/laser_af/Kconfig
```kconfig
config CAMERA_LASER_AF_VL53L5_OBJ
	tristate "Use VL53L5"
	depends on EXYNOS_DEVICE_CAMERA_MODULE
	depends on SENSORS_VL53L5
	default n
	help
	  Use to build VL53L5 driver.
```

## drivers/media/platform/exynos/camera/sensor/module_framework/ois/Kconfig
```kconfig
menuconfig CAMERA_OIS_SELECT
	bool "OIS select"
	depends on EXYNOS_DEVICE_CAMERA_MODULE
	help
	  Say Y here to enable support for platform-specific V4L drivers.

config CAMERA_OIS_BU24218GWL_OBJ
        bool "Use BU24218GWL ois"
	depends on CAMERA_OIS_SELECT
        default n
        help
          Use to build BU24218GWL ois.

config CAMERA_OIS_IDG2030_OBJ
	bool "Use IDG2030 ois"
	depends on CAMERA_OIS_SELECT
	default n
	help
	  Use to build IDG2030 ois

config OIS_DIRECT_FW_CONTROL
	bool "Use ois direct FW control"
	depends on CAMERA_OIS_SELECT
	default n
	help
	  Use to ois direct FW control.
```

## drivers/media/platform/exynos/camera/sensor/module_framework/pafstat/Kconfig
```kconfig
config CAMERA_PAFSTAT
	bool "Use PAFSTAT"
	depends on EXYNOS_DEVICE_CAMERA_MODULE
	default n
	help
	  Use to build PAF_STAT.
```

## drivers/media/platform/exynos/camera/vendor/Kconfig
```kconfig
#menu depth2
menu "Vendor Feature Setting"
	depends on EXYNOS_PABLO_ISP

choice VENDER_FEATURES
	prompt "Use vender features"
	depends on EXYNOS_PABLO_ISP
	default CAMERA_VENDER_DEFAULT
	help
	  Use the vender specific features.

config CAMERA_VENDER_DEFAULT
        bool "Default"
config CAMERA_VENDER_MCD
        bool "MCD"
endchoice

source "drivers/media/platform/exynos/camera/vendor/default/Kconfig"
source "drivers/media/platform/exynos/camera/vendor/mcd/Kconfig"
endmenu
```

## drivers/media/platform/exynos/camera/vendor/default/Kconfig
```kconfig
#
# Generic vendor feature config states
#

# Enable the vendor features
config SECURE_CAMERA_USE
	tristate "Use secure camera"
	depends on CAMERA_VENDER_DEFAULT
	default n
	---help---
	  Use secure camera.
```
