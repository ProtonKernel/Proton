## drivers/media/platform/exynos/camera/ischain/Kconfig
```kconfig
config EXYNOS_PABLO_ISP
	bool "Use Chain driver"
	depends on VIDEO_EXYNOS_PABLO_ISP
	default y
	help
	  This config abstracts driver source folder.

choice PABLO_HW_VERSION
	prompt "Select Pablo HW Version"
	depends on EXYNOS_PABLO_ISP
	help
	  Select Pablo ISP Version.

source "drivers/media/platform/exynos/camera/ischain/is-v8_1_0/Kconfig"
source "drivers/media/platform/exynos/camera/ischain/is-v8_10_0/Kconfig"
source "drivers/media/platform/exynos/camera/ischain/is-v8_20_0/Kconfig"

source "drivers/media/platform/exynos/camera/ischain/is-v9_1_0/Kconfig"

endchoice
```

## drivers/media/platform/exynos/camera/ischain/is-v8_10_0/Kconfig
```kconfig
config PABLO_V8_10_0
	bool "Use PABLO v8.10.0"
	depends on SOC_EXYNOS9630
	select EXYNOS_DEVICE_MIPI_CSIS_VER4
	select CSIS_V5_3
	select CAMERA_CIS_SELECT
	select CAMERA_ACT_SELECT
	select CAMERA_FLASH_SELECT
	select CAMERA_PDP
	select MC_SCALER_V8_10
	select PDP_V1_0_0
	help
	  PABLO ISP version 8.0.0
```

## drivers/media/platform/exynos/camera/ischain/is-v8_1_0/Kconfig
```kconfig
config PABLO_V8_1_0
	bool "Use PABLO v8.1.0"
	depends on SOC_EXYNOS9830
	select EXYNOS_DEVICE_MIPI_CSIS_VER4
	select CSIS_V5_3
	select CAMERA_CIS_SELECT
	select CAMERA_ACT_SELECT
	select CAMERA_FLASH_SELECT
	select CAMERA_PDP
	select MC_SCALER_V8_1
	select PDP_V1_0_0
	help
	  PABLO ISP version 8.1.0
```

## drivers/media/platform/exynos/camera/ischain/is-v8_20_0/Kconfig
```kconfig
config PABLO_V8_20_0
	bool "Use PABLO v8.20.0"
	depends on SOC_EXYNOS3830
	select EXYNOS_DEVICE_MIPI_CSIS_VER4
	select CSIS_V1_2
	select CAMERA_CIS_SELECT
	select CAMERA_ACT_SELECT
	select CAMERA_FLASH_SELECT
	select MC_SCALER_V8_20
	help
	  PABLO ISP version 8.20.0
```

## drivers/media/platform/exynos/camera/ischain/is-v9_1_0/Kconfig
```kconfig
config PABLO_V9_1_0
	bool "Use PABLO v9.1.0"
	depends on SOC_EXYNOS2100
	select EXYNOS_DEVICE_MIPI_CSIS_VER4
	select CSIS_V5_4
	select CAMERA_CIS_SELECT
	select CAMERA_ACT_SELECT
	select CAMERA_FLASH_SELECT
	select CAMERA_PDP
	select CAMERA_DVFS_V2
	select MC_SCALER_V9_1
	select PDP_V3_1
	select YUVPP_V2_1
	help
	  PABLO ISP version 9.1.0
```

## drivers/media/platform/exynos/camera/sensor/Kconfig
```kconfig
config EXYNOS_DEVICE_MIPI_CSIS_VER4
	bool "Use Sensor driver (Sensor Group)"
	depends on USE_SENSOR_GROUP
	depends on VIDEO_EXYNOS_PABLO_ISP
	default n
	help
	  Enable Device MIPI-CSIS S/W Version 4(Including WDMA and Sensor Group)

source "drivers/media/platform/exynos/camera/sensor/csi2/Kconfig"

config EXYNOS_DEVICE_CAMERA_MODULE
	bool "Use Camera modules"
	depends on VIDEO_EXYNOS_PABLO_ISP
	default y
	help
	  Select camera module.

source "drivers/media/platform/exynos/camera/sensor/module_framework/Kconfig"
```

## drivers/media/platform/exynos/camera/sensor/csi2/Kconfig
```kconfig
config CSIS_V1_2
	bool "Use CSI H/W v1.2"
	depends on VIDEO_EXYNOS_PABLO_ISP
	help
	  csi version 1.2

config CSIS_V5_2
	bool "Use CSI H/W v5.2"
	depends on VIDEO_EXYNOS_PABLO_ISP
	help
	  csi version 5.2

config CSIS_V5_3
	bool "Use CSI H/W v5.3"
	depends on VIDEO_EXYNOS_PABLO_ISP
	help
	  csi version 5.3

config CSIS_V5_4
	bool "Use CSI H/W v5.4"
	depends on VIDEO_EXYNOS_PABLO_ISP
	help
	  csi version 5.4
```

## drivers/media/platform/exynos/camera/sensor/module_framework/Kconfig
```kconfig
source "drivers/media/platform/exynos/camera/sensor/module_framework/cis/Kconfig"
source "drivers/media/platform/exynos/camera/sensor/module_framework/actuator/Kconfig"
source "drivers/media/platform/exynos/camera/sensor/module_framework/laser_af/Kconfig"
source "drivers/media/platform/exynos/camera/sensor/module_framework/flash/Kconfig"
source "drivers/media/platform/exynos/camera/sensor/module_framework/ois/Kconfig"
source "drivers/media/platform/exynos/camera/sensor/module_framework/aperture/Kconfig"
source "drivers/media/platform/exynos/camera/sensor/module_framework/pafstat/Kconfig"
source "drivers/media/platform/exynos/camera/sensor/module_framework/eeprom/Kconfig"
```

## drivers/media/platform/exynos/camera/sensor/module_framework/actuator/Kconfig
```kconfig
menuconfig CAMERA_ACT_SELECT
	tristate "Actuator select"
	depends on EXYNOS_DEVICE_CAMERA_MODULE
	help
	  Say Y here to enable support for platform-specific V4L drivers.

config CAMERA_ACT_AK7348_OBJ
        tristate "Use actuator AK7348"
	depends on CAMERA_ACT_SELECT
        default n
        help
          Use to build AK7348 driver.

config CAMERA_ACT_AK7345_OBJ
        tristate "Use actuator AK7345"
	depends on CAMERA_ACT_SELECT
        default n
        help
          Use to build AK7345 driver.

config CAMERA_ACT_AK7371_OBJ
        tristate "Use actuator AK7371"
	depends on CAMERA_ACT_SELECT
        default n
        help
          Use to build AK7371 driver.

config CAMERA_ACT_DW9714_OBJ
        tristate "Use actuator DW9714"
	depends on CAMERA_ACT_SELECT
        default n
        help
          Use to build DW9714 driver.

config CAMERA_ACT_DW9780_OBJ
        tristate "Use actuator DW9780"
	depends on CAMERA_ACT_SELECT
        default n
        help
          Use to build DW9780 driver.

config CAMERA_ACT_DW9804_OBJ
        tristate "Use actuator DW9804"
	depends on CAMERA_ACT_SELECT
        default n
        help
          Use to build DW9804 driver.

config CAMERA_ACT_DW9807_OBJ
        tristate "Use actuator DW9807"
	depends on CAMERA_ACT_SELECT
        default n
        help
          Use to build DW9807 driver.

config CAMERA_ACT_DW9808_OBJ
        tristate "Use actuator DW9808"
	depends on CAMERA_ACT_SELECT
        default n
        help
          Use to build DW9808 driver.

config CAMERA_ACT_DW9823_OBJ
        tristate "Use actuator DW9823"
	depends on CAMERA_ACT_SELECT
        default n
        help
          Use to build DW9823 driver.

config CAMERA_ACT_DW9839_OBJ
        tristate "Use actuator DW9839"
	depends on CAMERA_ACT_SELECT
        default n
        help
          Use to build DW9839 driver.

config CAMERA_ACT_AK7372_OBJ
        tristate "Use actuator AK7372"
	depends on CAMERA_ACT_SELECT
        default n
        help
          Use to build AK7372 driver.

config CAMERA_ACT_LC898217_OBJ
        tristate "Use actuator LC898217"
	depends on CAMERA_ACT_SELECT
        default n
        help
          Use to build LC898217 driver.

config CAMERA_ACT_AK737X_OBJ
        tristate "Use actuator AK737X"
	depends on CAMERA_ACT_SELECT
        default n
        help
          Use to build AK737X driver.

config CAMERA_ACT_ZC533_OBJ
        tristate "Use actuator ZC533"
	depends on CAMERA_ACT_SELECT
        default n
        help
          Use to build ZC533 driver.

config CAMERA_ACT_ZC569_OBJ
        tristate "Use actuator ZC569"
	depends on CAMERA_ACT_SELECT
        default n
        help
          Use to build ZC569 driver.
```

## drivers/media/platform/exynos/camera/sensor/module_framework/aperture/Kconfig
```kconfig
menuconfig CAMERA_APERTURE_SELECT
	bool "Aperture select"
	depends on EXYNOS_DEVICE_CAMERA_MODULE
	help
	  Say Y here to enable support for platform-specific V4L drivers.

config CAMERA_APERTURE_AK7372_OBJ
	bool "Use aperture AK7372"
	depends on CAMERA_APERTURE_SELECT
	default n
	help
	  Use to build AK7372 driver.
```
