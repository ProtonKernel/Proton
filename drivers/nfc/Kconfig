## drivers/nfc/Kconfig
```kconfig
#
# Near Field Communication (NFC) devices
#
config SAMSUNG_NFC
	tristate "Samsung NFC driver for module build"
	default n
	help
	  Say Y here if you want to build support for NFC (Near field
	  communication) devices.
	  To compile this support as a module, choose M here: the module will
	  be called nfc.

config SEC_NFC
	bool "Samsung NFC driver"
	default n
	help
	  SAMSUNG NFC Driver.
	  This driver provides support for SAMSUNG NFC products.
	  You should select your NFC product and interface.

	  Say Y here to compile support for SAMSUNG NFC driver into the
	  kernel.

config NFC_PVDD_LATE_ENABLE
        bool "PVDD late enable"
        default n
        help
          If lpcharge value is not usable,
          then PVDD is enabled lately by init.nfc.samsung.rc on late-init.
          And this should be enabled from S os projects.

config ESE_P3_LSI
	bool "eSE driver"
	depends on SPI
	default n
	help
	  Oberthur Driver.
	  This driver provides support for LSI NXP combined ESE products.
	  You should select your NFC product and interface.

	  Say Y here to compile support for eSE driver into the kernel.

config ESE_COLDRESET
	bool "eSE support coldreset"
	depends on ESE_P3_LSI
	default n
	help
	  Cold reset function supported.
	  This function supports for LSI ESE products.
	  You should select your NFC product and interface.

	  Say Y here to compile support for eSE driver into the kernel.

config ESE_USE_REGULATOR
	bool "eSE use regulator"
	depends on ESE_P3_LSI
	default n
	help
	  ESE is on and off by regulator.
	  This function supports for LSI ESE products.
	  You should select your NFC product and interface.

	  Say Y here to compile support for eSE driver into the kernel.

config MAKE_NODE_USING_PLATFORM_DEVICE
        bool "eSE platform driver"
        default n
        help
          Using eSE platform driver.
          Sometimes eSE node is created after permission setting
          cause of SPI driver dependency.
          So, use platform driver to make node first.

config ESE_FACTORY_ONLY
	bool "eSE driver factory"
	depends on SPI
	default n
	help
	  Oberthur Driver.
	  This driver provides support for LSI NXP combined ESE products.
	  You should select your NFC product and interface.

config ESE_SECURE
	bool "ESE Secure Controller Driver"
	depends on !SEC_FACTORY
	default n
	help
	  Common eSE Secure controller support.
	  This option enables device driver support for the eSE with NFC.
	  It is used by many services. eSE is fully controlled using SPI
	  to communication

config ESE_USE_TZ_API
        bool "use tz api"
        default n
        help
          Enable when using TZ API.

config SEC_NFC_LOGGER
	bool "NFC logger"
	default n
	help
	  Enable NFC log.
	  NFC log will be recorded at proc folder.
	  but will not included at dumpstate log.
	  so need to copy this file to log folder.

config SEC_NFC_DUPLICATED_IRQ_WQ_LSI
	bool "NFC duplicated irq wq lsi"
	default n
	help
	  Enable NFC duplicated irq LSI w/a.
	  If the interrupt occurs twice continuously, the i2c_info.
	  read_irq value is returned to the previous value.
	  Apply W/A received from LSI

config SEC_NFC_DUPLICATED_IRQ_WQ_QC
	bool "NFC duplicated irq wq qc"
	default n
	help
	  Enable NFC duplicated irq QC solution.
	  add the IRQF_NO_SUSPEND flag during interrupt registration
	  and do not use enable_irq_wake() api to configure the GPIO
	  as wakeup capable.

config SEC_NFC_WAKELOCK_METHOD
        int "nfc wakelock method"
        default 0
        help
          Different functions must be used depending on the kernel version
          for wakelock initialization.
          0 - auto selection
          1 - wakeup_source_init
          2 - wakeup_source_register

config NFC_PN547
	bool "NXP PN547 NFC Controller Driver"
	depends on I2C
	default n
	help
	  NXP PN547 Near Field Communication controller support.
	  This option enables device driver support for the NFC.
	  It is used by many services. NFC is fully controlled using I2C
	  to communication.

config NFC_FEATURE_SN100U
	bool "NXP SN100U Feature"
	default n
	help
	  NXP SN100U Near Field Communication controller support
	  This option enables device driver support for the NFC.
	  It is used by many services. NFC is fully controlled using I2C
	  to communicate the AP chip.

config NFC_PN547_CLK_BBCLK2
	bool "NXP PN547 NFC CLOCK Controller"
	depends on NFC_PN547
	default n
	help
	  NXP PN547 Near Field Communication controller support.
	  This option enables device driver support for the NFC.
	  It is used by many services. NFC is fully controlled using I2C
	  to communicate the AP chip.

config NFC_P61
	bool "NXP PN547 NFC Controller Driver"
	depends on SPI
	default n
	help
	  NXP PN547 Near Field Communication controller support.
	  This option enables device driver support for the NFC.
	  It is used by many services. NFC is fully controlled using I2C
	  to communication

config NFC_PN547_ESE_SUPPORT
	bool "NXP PN547 ESE SUPPORT"
	depends on NFC_PN547
	default n
	help
	  NXP PN547 Near Field Communication controller support.
	  This option enables device driver support for the NFC.
	  It is used by many services. NFC is fully controlled using I2C
	  to communication

config NFC_PN547_LDO_CONTROL
	bool "PN547 NFC LDO CONTROL"
	depends on NFC_PN547
	default n
	help
	  SAMSUNG PN547 NFC LDO CONTROL feature.
	  This feature provides support for NXP PN547 products.
	  You should select this feature if your NFC product uses ldo control of i2c.

	  Say Y here to compile support for NXP PN547 LDO CONTROL feature into the
	  kernel.

config SEC_NFC_LOGGER
        bool "NFC logger"
        default n
        help
          Enable NFC log.
          NFC log will be recorded at proc folder.
          but will not included at dumpstate log.
          so need to copy this file to log folder.

config SEC_NFC_LOGGER_ADD_ACPM_LOG
        bool "NFC logger: add acpm log"
        default n
        depends on SEC_NFC_LOGGER
        help
          add acpm log.
          this feature is for particualr AP.
          rtc reg addr is needed to compare time

config SEC_NFC_LOGGER_RTC_REG_ADDR
        hex "NFC logger: add acpm log"
        default 0x0
        depends on SEC_NFC_LOGGER_ADD_ACPM_LOG
        help
          RTC time is to compare between acpm and kernel.
          address value is hex.

config NFC_QTI_I2C
        tristate "QTI NCI based NFC I2C Driver for SNxxx"
        depends on I2C
        help
          This enables the NFC driver for SNxxx based devices.
          This is for I2C connected version. NCI protocol logic
          resides in the usermode and it has no other NFC dependencies.

          If unsure, say N.

config SEC_NFC_COMPAT_IOCTL
        bool "NFC compat ioctl"
        default n
        help
          Enable NFC compat ioctl.

config SEC_STAR
        tristate "LSI star platform"
        default n
        help
          LSI star platform
          This driver provides support for LSI star platform.

config STAR_MEMORY_LEAK
        bool "memory leak test in sec-star"
        help
          memory leak test in sec-star.
          All allocated memory are listed in array.

config STAR_K250A
        bool "S.LSI k250a driver"
        help
          S.LSI k250a driver except ISO7816 protocol layer
          This driver provides support for S.LSI k250a product.
```

## drivers/optics/Kconfig
```kconfig
config SENSORS_FLICKER_SELF_TEST
	tristate "Flicker EOL test use flash"
	help
		make Test environment using led flash.

config SENSORS_STK3A8X
    tristate "sensortek stk3a8x light device driver"
    depends on I2C
    help
        If you say yes here, you get support for the stk3a8x.
```

## drivers/pinctrl/samsung/Kconfig
```kconfig
# SPDX-License-Identifier: GPL-2.0
#
# Samsung Pin control drivers
#
config PINCTRL_SAMSUNG
	tristate "Pinctrl driver data for Samsung SoCs"
	select PINMUX
	select PINCONF

config PINCTRL_EXYNOS
	bool "Pinctrl driver data for Samsung EXYNOS SoCs"
	depends on OF && GPIOLIB && (ARCH_EXYNOS || ARCH_S5PV210)
	select PINCTRL_EXYNOS_ARM if ARM && (ARCH_EXYNOS || ARCH_S5PV210)
	select PINCTRL_EXYNOS_ARM64 if ARM64 && ARCH_EXYNOS

config PINCTRL_EXYNOS_ARM
	bool "ARMv7-specific pinctrl driver data for Exynos" if COMPILE_TEST
	depends on PINCTRL_EXYNOS

config PINCTRL_EXYNOS_ARM64
	bool "ARMv8-specific pinctrl driver data for Exynos" if COMPILE_TEST
	depends on PINCTRL_EXYNOS

config PINCTRL_S3C24XX
	bool "Samsung S3C24XX SoC pinctrl driver"
	depends on ARCH_S3C24XX && OF

config PINCTRL_S3C64XX
	bool "Samsung S3C64XX SoC pinctrl driver"
	depends on ARCH_S3C64XX

config PINCTRL_SEC_GPIO_DVS
	tristate "Samsung GPIO debugging and verification system"
	depends on SEC_PM && PINCTRL_EXYNOS_ARM64
	default m if SEC_FACTORY=y
```

## drivers/pwm/pwm-config/Kconfig
```kconfig
config PWM_CONFIG
	tristate "translate gpio to pwm for exynos"
	depends on OF
	help
	  PWM pinctrl configuration for ARCH_EXYNOS
	  If not sure, set n
	  This codes only works with sec_pwm phandle
	  check the samsung,pwm-outputs and pwm id
```

## drivers/samsung/Kconfig
```kconfig
# drivers/samsung/debug/Kconfig
#
# Copyright (c) 2010-2020 Samsung Electronics Co., Ltd.
#               http://www.samsung.com/
#
# Licensed under GPLv2

menu "Samsung TN Extension Feature"
config SEC_EXT
	bool "Samsung TN extension Feature"
	default y

menuconfig SEC_DEBUG
	tristate "Enable Samsung Debugging features"
	default n

config SEC_REBOOT
	tristate "Enable TN reboot features"
	default n
	help
	  Samsung TN reboot extension Feature. Do additional work when reboot.

config SEC_PMIC_PWRKEY
	bool "Enable PMIC power key for key crash"
	help
	  SEC key crash for PMIC power key.

config SEC_PMIC_PWRKEY_DTNAME
	string "PMIC power key dt node name"
	depends on SEC_PMIC_PWRKEY
	default ""
	help
	  Select PMIC power key dt node with key code.

config SEC_KEY_NOTIFIER
	tristate "Enable Samsung key event notifier"
	default n
	help
	  Samsung Key input event notifier

config SEC_PARAM
	tristate "Enable Param modification"
	default n
	help
	  Samsung TN Param Feature.

config SEC_BOOTSTAT
	tristate "Enable TN Bootstat logging"
	depends on SEC_EXT
	default n
	help
	  This adds support for Samsung boot-stat
	  To compile this driver as a module, choose M here.

config DRV_SAMSUNG
	tristate "Samsung sec class/sysfs Feature"
	depends on SEC_EXT
	default n
	help
	  Samsung sysfs name 'sec' directory create.

config ARGOS
	tristate "Throughput monitoring Feature"
	default n
	help
	  This option enables monitoring the data throughput and doing several actions for
	  enhancing the performance such as adjusting the CPU freqency, allocating the tasks
	  to the appropriate CPU and so on

config ARGOS_CLUSTER_NUM
	int "The number of CPU clusters (1 ~ 3)"
	range 1 3
	depends on ARGOS
	default 2
	help
	  This option enables that argos supports 3 clusters in SMP nodes.

comment "Samsung TN Build Options"
config SEC_FACTORY
	bool "SAMSUNG Factory build option"
	depends on SEC_EXT
	default n
	select SEC_PANIC_PCIE_ERR
	help
	  Include some codes for Factory binary.
	  This option is enabled by Factory build option.
	  In samsung build script, '-F' enables this option.

config SAMSUNG_PRODUCT_SHIP
	bool "set up for product shipping"
	depends on SEC_EXT
	default n
	help
	  This option is enabled by SHIP build option.
	  In samsung build script, '-s' enables this option.

endmenu
source "drivers/samsung/misc/Kconfig"
source "drivers/samsung/pm/Kconfig"
```
