## drivers/soc/samsung/acpm/Kconfig
```kconfig
#
# ACPM driver configuration
#

menuconfig EXYNOS_ACPM
	tristate "ACPM driver support"
	depends on ARCH_EXYNOS
	default n
	help
	  Enable ACPM support

if EXYNOS_ACPM

config EXYNOS7570_ACPM
	bool "EXYNOS7570_ACPM support"
	default y
	depends on SOC_EXYNOS7570
	help
	  Enable ACPM support

config EXYNOS7270_ACPM
	bool "EXYNOS7270_ACPM support"
	default y
	depends on SOC_EXYNOS7270
	help
	  Enable ACPM support

config EXYNOS8895_ACPM
	bool "EXYNOS8895_ACPM support"
	default y
	depends on SOC_EXYNOS8895
	help
	  Enable ACPM support

config EXYNOS9810_ACPM
	bool "EXYNOS9810_ACPM support"
	default y
	depends on SOC_EXYNOS9810
	help
	  Enable ACPM support

config EXYNOS9610_ACPM
	bool "EXYNOS9610_ACPM support"
	default y
	depends on SOC_EXYNOS9610
	help
	  Enable ACPM support

config EXYNOS_ACPM_MFD
	bool "EXYNOS_ACPM_MFD support"
	depends on EXYNOS_ACPM
	default y
	help
	  Enable ACPM_MFD support

config EXYNOS_ACPM_S2D
	tristate "EXYNOS_ACPM_S2D support"
	help
	  Enable ACPM_S2D support

config EXYNOS_ACPM_PLGDBG
	tristate "EXYNOS ACPM plugin debugfs support"
	help
	  Enable PLUGIN_DBG support
endif
```

## drivers/soc/samsung/debug/Kconfig
```kconfig
menuconfig EXYNOS_DEBUG
        bool "Exynos Debug Features"
        depends on ARCH_EXYNOS
        default n

if EXYNOS_DEBUG
menuconfig DEBUG_SNAPSHOT
	tristate "Debug SnapShot Support"
	depends on EXYNOS_DEBUG
	default n

config DEBUG_SNAPSHOT_FREQ_DOMAIN_NUM
	int "Number of freq logging domain type"
	range 4 32
	default 32

config DEBUG_SNAPSHOT_LOG_ITEM_SIZE
	int "Number of logging item base size"
	range 128 1024
	default 1024

config DEBUG_SNAPSHOT_BUILT_IN
	bool "Debug SnapShot Built-In Support"
	depends on DEBUG_SNAPSHOT
	default y

config DEBUG_SNAPSHOT_SFRDUMP
	tristate "Debug Snapshot SFRDUMP"
	depends on DEBUG_SNAPSHOT
	default n

config DEBUG_SNAPSHOT_QUICKDUMP
	tristate "Debug Snapshot quickdump"
	depends on DEBUG_SNAPSHOT
	default n

config EXYNOS_DEBUG_TEST
        tristate "Exynos debug feature test"
        depends on DEBUG_SNAPSHOT
        default n

config EXYNOS_ADV_TRACER
        tristate "Exynos Advanced Tracer"
        depends on EXYNOS_DEBUG
        default n

config EXYNOS_ADV_TRACER_S2D
        tristate "Exynos Advanced Tracer: Plug-in - S2D"
        depends on EXYNOS_ADV_TRACER
        default n

config EXYNOS_ITMON
        tristate "Exynos IPs Traffic Monitor"
        depends on EXYNOS_DEBUG
        default n

config EXYNOS_CORESIGHT
        tristate "Enable Coresight of exynos"
        depends on EXYNOS_DEBUG
        default n

config EXYNOS_ECC_HANDLER
	tristate "Exynos support ECC handler"
	depends on EXYNOS_DEBUG
	default n

config EXYNOS_EHLD
        tristate "Exynos support Early Hardlockup Detector"
        depends on EXYNOS_DEBUG
        default n

config EXYNOS_HARDLOCKUP_WATCHDOG
	tristate "Exynos Hardlockup Watchdog"
	depends on DEBUG_SNAPSHOT
	default n

config EXYNOS_HARDLOCKUP_DEBUG
	tristate "Exynos Hardlockup Debugger"
	depends on DEBUG_SNAPSHOT
	default n

config EXYNOS_SSLD
        tristate "Exynos support S2R Scenario Lockup Detector"
        depends on EXYNOS_DEBUG
        default n
endif
```

## drivers/soc/samsung/xperf/Kconfig
```kconfig
#
# Exynos CPU Performance Profiling
#
config EXYNOS_PERF
	tristate "Exynos Performance Drivers"
	default m
	help
	  Enable Exynos Performance Drivers
```

## drivers/staging/android/ion/heaps/Kconfig
```kconfig
# SPDX-License-Identifier: GPL-2.0
config ION_SYSTEM_HEAP
	tristate "Ion system heap"
	depends on ION
	help
	  Choose this option to enable the Ion system heap. The system heap
	  is backed by pages from the buddy allocator. If in doubt, say Y.

config ION_CMA_HEAP
	tristate "Ion CMA heap support"
	depends on ION && DMA_CMA
	help
	  Choose this option to enable CMA heaps with Ion. This heap is backed
	  by the Contiguous Memory Allocator (CMA). If your system has these
	  regions, you should say Y here.

config ION_RBIN_HEAP
	bool "ION RBIN Heap"
	default y
	depends on ION && RBIN && CLEANCACHE
	help
	  Provides ION RBIN heap which utilizes RBIN memory.
	  While RBIN heap is similar with CMA heap, it assumes that an ION buffer
	  can be composed of multiple free chunks.
```

## drivers/sti/abc/Kconfig
```kconfig
comment "Samsung ABC Options"
config SEC_ABC
	tristate "Samsung ABC Feature"
	depends on SEC_STI
	default n
	help
	  Samsung ABC(Abnormal Behavior Catcher) Driver Feature
	  This driver is to catch abnormal behavior in each device drivers
	  It depends on SEC_STI Feature

comment "Samsung ABC Common Options"
config SEC_ABC_COMMON
	tristate "Samsung ABC COMMON Feature"
	depends on SEC_ABC
	default y
	help
	  Samsung ABC(Abnormal Behavior Catcher) Driver Common Feature
	  This config is for ABC Driver Core Code
	  It depends on SEC_ABC Feature

comment "Samsung ABC MOTTO Options"
config SEC_ABC_MOTTO
	tristate "Samsung ABC MOTTO Feature"
	depends on SEC_ABC
	default n
	help
	  Samsung ABC(Abnormal Behavior Catcher) MOTTO Function Feature
	  This config is to support MOTTO Function
	  It depends on SEC_ABC Feature

comment "Samsung ABC_COMMON KUNIT Options"
config SEC_ABC_COMMON_KUNIT
	tristate "Samsung ABC_COMMON KUNIT Feature"
	depends on SEC_ABC && SEC_KUNIT
	default n
	help
	  Samsung ABC(Abnormal Behavior Catcher) KUNIT Function Feature
	  This config is to support ABC_COMMON KUNIT Function
	  It depends on SEC_ABC && SEC_KUNIT Feature

comment "Samsung ABC Hub Options"
config SEC_ABC_HUB
	tristate "Samsung ABC Hub Feature"
	depends on SEC_ABC
	default n
	help
	  Samsung ABC(Abnormal Behavior Catcher) Hub Driver Feature
	  This config controls ABC Hub driver which supports ABC Driver
	  And it consists of abc_hub_core & abc_hub_cond & abc_hub_bootc.
	  It depends on SEC_ABC Feature

comment "Samsung ABC Hub Core Options"
config SEC_ABC_HUB_CORE
	bool "Samsung ABC Hub Core Feature"
	depends on SEC_ABC_HUB
	default y
	help
	  Samsung ABC(Abnormal Behavior Catcher) Hub Driver's Core Feature
	  This function controls sub modules for supporting ABC Driver
	  It depends on SEC_ABC_HUB Feature

comment "Samsung ABC Hub Connect Detect Options"
config SEC_ABC_HUB_COND
	bool "Samsung ABC Hub Connect Detect Feature"
	depends on SEC_ABC_HUB
	depends on !SEC_FACTORY
	default n
	help
	  Samsung COND(Connect Detect) Feature
	  This function is to detect connect h/w problem
	  It is sub module of ABC Hub Driver
	  It depends on SEC_ABC_HUB Feature
	  
comment "Samsung ABC Hub Connect Detect Options"
config SEC_ABC_HUB_COND_DAVINCI
	bool "Samsung Davinci ABC Hub Connect Detect Feature"
	depends on SEC_ABC_HUB_COND
	default n
	help
	  Samsung COND(Connect Detect) Feature
	  This function is to detect connect h/w problem
	  It is sub module of ABC Hub Driver
	  It depends on SEC_ABC_HUB Feature

comment "Samsung ABC Hub Booting Time Check Options"
config SEC_ABC_HUB_BOOTC
	bool "Samsung ABC Hub Booting Time Check Feature"
	depends on SEC_ABC_HUB
	default n
	help
	  Samsung BOOTC(Booting Time Check) Feature
	  This function is to check booting time
	  It is sub module of ABC Hub Driver
	  It depends on SEC_ABC_HUB Feature

comment "Samsung ABC Hub Booting Time Check eng mode Options"
config SEC_ABC_HUB_BOOTC_ENG
	bool "Samsung ABC Hub Booting Time Check eng mode Feature"
	depends on SEC_ABC_HUB_BOOTC
	default n
	help
	  Samsung BOOTC(Booting Time Check) eng mode Feature
	  This function is to apply eng binary booting time spec
	  It depends on SEC_ABC_HUB_BOOTC Feature

comment "Samsung ABC_HUB KUNIT Options"
config SEC_ABC_HUB_KUNIT
	tristate "Samsung ABC_HUB KUNIT Feature"
	depends on SEC_ABC_HUB && SEC_KUNIT
	default n
	help
	  Samsung ABC(Abnormal Behavior Catcher) Hub KUNIT Function Feature
	  This config is to support ABC Hub KUNIT Function
	  It depends on SEC_ABC_HUB && SEC_KUNIT Feature
```

## drivers/thermal/samsung/Kconfig
```kconfig
# SPDX-License-Identifier: GPL-2.0-only
config EXYNOS_THERMAL_V2
	tristate "Exynos thermal management unit driver"
	depends on THERMAL_OF
	depends on HAS_IOMEM
	help
	  If you say yes here you get support for the TMU (Thermal Management
	  Unit) driver for SAMSUNG EXYNOS series of SoCs. This driver initialises
	  the TMU, reports temperature and handles cooling action if defined.
	  This driver uses the Exynos core thermal APIs and TMU configuration
	  data from the supported SoCs.

config EXYNOS_ACPM_THERMAL
	tristate "Exynos ACPM TMU plug-in support"
	depends on EXYNOS_THERMAL_V2
	help
	  This feature supports ACPM TMU plug-in for Exynos thermal driver.

config GPU_THERMAL
	tristate "generic gpu cooling support"
	depends on EXYNOS_THERMAL_V2
	help
	  This implements the generic gpu cooling mechanism through frequency
	  reduction.

	  If you want this support, you should say Y here.

config ISP_THERMAL
	tristate "generic isp cooling support"
	depends on EXYNOS_THERMAL_V2
	help
	  This implements the generic isp cooling mechanism through fps
	  reduction.

	  If you want this support, you should say Y here.

config DEV_THERMAL
	tristate "Exynos dev cooling support"
	depends on EXYNOS_THERMAL_V2
	help
	  This implements the Exynos devfreq cooling mechanism through frequency
	  reduction.

	  If you want this support, you should say Y here.

config EXYNOS_CPU_THERMAL
	tristate "generic cpu cooling support"
	depends on ARM_EXYNOS_ACME
	depends on EXYNOS_THERMAL_V2
	help
	  This implements the generic cpu cooling mechanism through frequency
	  reduction. An ACPI version of this already exists
	  (drivers/acpi/processor_thermal.c).
	  This will be useful for platforms using the generic thermal interface
	  and not the ACPI interface.

	  If you want this support, you should say Y here.
```

## drivers/usb/typec/maxim/Kconfig
```kconfig
#
# CCIC devices
#

comment "CCIC configs"

config CCIC_MAX77705
	tristate "CCIC 77705"
	depends on I2C
	default n
	help
	  If you say yes here you will get support for
	  max77705 ccic full version chipset

config MAXIM_CCIC_ALTERNATE_MODE
	bool "support alternate mode"
	depends on CCIC_MAX77705
	default n
	help
	  If you say yes here you will get support for
	  alternate mode function with max77705 ccic chipset

config CCIC_MAX77705_DEBUG
	bool "CCIC 77705 DEBUG"
	depends on CCIC_MAX77705
	default n
	help
	  If you say yes here you will get support for
	  debugging feature with max77705 ccic chipset

config MAX77705_FW_PID03_SUPPORT
	bool "support MAX77705 FW PID 0x03"
	depends on CCIC_MAX77705
	default n
	help
	  If you say yes here you will get support for
	  specified firmware with max77705 ccic chipset

config MUIC_MAX77705
	tristate "Using MAX77705 MUIC"
	depends on USE_MUIC
	default n
	help
	  If you say yes here you will get support for
	  the MAX77705 MUIC chip.
	  To enable this driver,
	  USE_MUIC should be enabled.

config HV_MUIC_MAX77705_AFC
	tristate "Using MAX77705 AFC MUIC"
	default n
	help
	  If you say yes here you will get support for
	  the MAX77705 AFC MUIC.
	  To enable this driver,
	  MUIC_MAX77705 should be enabled.

config MUIC_MAX77705_PDIC
	tristate "Using MAX77705 MUIC supports CCIC chip interface"
	default n
	help
	  If you say yes here you will get support for
	  the CCIC chip with MAX77705 MUIC.
	  To enable this driver,
	  MUIC_MAX77705 and MUIC_SUPPORT_CCIC should be enabled.

config AFC
	bool "Using MAX77705 AFC"
	default n
	help
	  If you say yes here you will get support for
	  the MAX77705 AFC.
	  To enable this driver,
	  MUIC_MAX77705 should be enabled.

config SUPPORT_QC30
	bool "SUPPORT_QC30"
	default n
	help
	  If you say yes here you will get support for the QC3.0 charger.

config MUIC_QC_DISABLE
	bool "Using QC charging"
	depends on USE_MUIC
	default n
	help
	  If you say yes here you will not get support for the QC charging

config UPGRADED_WATER_DETECT
	bool "Using improved water detection"
	depends on CCIC_MAX77705
	default n
	help
	  If you say yes here you will get support for extra water detection
	  driver will check if it is water + no VBUS + no hiccup state,
	  and if the condition is satisfied, it will reset IC.

config GET_UNMASK_VBUS_HWPARAM
	bool "Using get unmask vbus hw param"
	depends on CCIC_MAX77705
	default n
	help
	  If you say yes here you will get support for getting unmask vbus hw param
	  driver will check if it is attach/detach repeat state,
	  and if the condition is satisfied, it will get the hw param.

config MUIC_DISABLE_CHGDET
	bool "Using disable chgdet"
	default n
	help
	  If you say yes here you will get support for disabling chgdet.
```

## drivers/vibrator/common/Kconfig
```kconfig
config SEC_VIBRATOR
	tristate "sec vibrator"
	default n
	help
	  If you say yes here you will get support for the
	  sec vibrator driver

config SEC_VIB_NOTIFIER
	tristate "use sec vibrator notifier"
	default n
	help
	  Enable notifier functions to get motor enable status
	  and timeout value by register notifiy
	  If you unsure, please select n

config SEC_VIBRATOR_TEST
	bool "KUnit test for sec_vibrator_test"
	depends on SEC_KUNIT
	help
	  This driver is for sec vibrator test driver
	  sec vibrator kunit test
	  If you want to add some functions,
	  Please make the test case.
```

## drivers/vibrator/maxim/Kconfig
```kconfig
config MAX77705_VIBRATOR
	tristate "Maxim MAX77705 vibrator"
	default n
	depends on MFD_MAX77705
	help
	  If you say yes here you will get support for the
	  motor of Maxim MAX77705 PMIC.
	  To enable this driver, MFD_MAX77705 should be enabled and
	  MFD_MAX77705 calls this driver.

config MAX77705_VIB_FOLD_MODEL
	tristate "get support for folder status "
	default n
	help
	  If you enable this feature,
	  you will get event for folder status
	  through event_cmd sysfs
```

## drivers/video/fbdev/exynos/Kconfig
```kconfig
MCD_PANEL_PATH := drivers/video/fbdev/exynos/panel
if SOC_EXYNOS2100 || SOC_EXYNOS9830 || SOC_EXYNOS9820 || SOC_EXYNOS9610 || UML

source "drivers/video/fbdev/exynos/dpu30/Kconfig"
source "drivers/video/fbdev/exynos/panel/Kconfig"
source "drivers/video/fbdev/exynos/dp_logger/Kconfig"

endif
```
