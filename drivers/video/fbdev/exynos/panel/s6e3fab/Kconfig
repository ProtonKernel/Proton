## drivers/video/fbdev/exynos/panel/s6e3fab/Kconfig
```kconfig
menuconfig EXYNOS_DECON_LCD_S6E3FAB
	tristate "S6E3FAB DDI Panel Driver"
	depends on MCD_PANEL && EXYNOS_MIPI_DSIM
	default n
	help
		This enables S6E3FAB DDI dependent panel drivers of
		common panel driver. say Y, if you have a panel based on
		the S6E3FAB DDI.
```

## drivers/video/fbdev/exynos/panel/s6e3fc3/Kconfig
```kconfig
menuconfig EXYNOS_DECON_LCD_S6E3FC3
	tristate "S6E3FC3 DDI Panel Driver"
	depends on MCD_PANEL && EXYNOS_MIPI_DSIM
	default n
	help
		This enables S6E3FC3 DDI dependent panel drivers of
		common panel driver. say Y, if you have a panel based on
		the S6E3FC3 DDI.
```

## drivers/video/fbdev/exynos/panel/s6e3hab/Kconfig
```kconfig
menuconfig EXYNOS_DECON_LCD_S6E3HAB
	tristate "S6E3HAB DDI Panel Driver"
	depends on MCD_PANEL && EXYNOS_MIPI_DSIM
	default n
	help
		This enables S6E3HAB DDI dependent panel drivers of
		common panel driver. say Y, if you have a panel based on
		the S6E3HAB DDI.
```

## drivers/video/fbdev/exynos/panel/s6e3had/Kconfig
```kconfig
menuconfig EXYNOS_DECON_LCD_S6E3HAD
	tristate "S6E3HAD DDI Panel Driver"
	depends on MCD_PANEL && EXYNOS_MIPI_DSIM
	default n
	help
		This enables S6E3HAD DDI dependent panel drivers of
		common panel driver. say Y, if you have a panel based on
		the S6E3HAD DDI.
```

## drivers/vision/Kconfig
```kconfig
menuconfig VISION_SUPPORT
	tristate "Vision Support"
	select VISION_CORE
	help
	  If you want to use hardware acceleration for vision
	  enable this option and other options below.

if VISION_SUPPORT

source "drivers/vision/vision-core/Kconfig"

source "drivers/vision/dsp/Kconfig"

source "drivers/vision/npu/Kconfig"

endif # VISION_SUPPORT
```

## drivers/vision/dsp/Kconfig
```kconfig
menuconfig EXYNOS_DSP
	tristate "EXYNOS dsp common driver"

if EXYNOS_DSP

config EXYNOS_DSP_HW_N1
	bool "Enable dsp driver for HW_N1"
	default n

config EXYNOS_DSP_HW_N3
	bool "Enable dsp driver for HW_N3"
	default n

config EXYNOS_DSP_HW_O1
	bool "Enable dsp driver for HW_O1"
	default n

config EXYNOS_DSP_HW_O3
	bool "Enable dsp driver for HW_O3"
	default n

endif
```

## drivers/vision/npu/core/Kconfig
```kconfig
menuconfig EXYNOS_NPU
	tristate "Exynos NPU driver (Test)"
	depends on VISION_CORE
	help
		Exynos NPU Test device driver

menuconfig EXYNOS_NPU_CORE
	tristate "Exynos NPU driver (TEST)"
	depends on EXYNOS_NPU
	help
		Exynos NPU core device driver

menuconfig EXYNOS_NPU_DRAM_FW_LOG_BUF
	bool "DRAM buffer for firmware test and debugging"
	depends on EXYNOS_NPU
	default y
	help
		When this option is enabled, 1MB buffer will be reserved at the start of
		device virtual address space to support firmware test and debugging.

menuconfig EXYNOS_NPU_PUBLISH_NPU_BUILD_VER
	bool "Print out update log on initialization."
	depends on EXYNOS_NPU
	default y
	help
		When this option is enabled, last git log messages and stash information
		is printed on NPU initialization, to track source code update.

menuconfig EXYNOS_NPU_DEBUG_SRAM_DUMP
	bool "SRAM dump interface"
	depends on EXYNOS_NPU
	default n
	help
		When this option is enabled, SRAM dump file is created on debugfs
		and the SRAM can be dumpted.

menuconfig EXYNOS_NPU_EXPOSE_KERNEL_ADDR
	bool "Expose kernel address value in log message"
	depends on EXYNOS_NPU
	default n
	help
		When this option is enabled, all kernel address logging is
		changed to %p instead of %pK, so the value will be visible without
		setting kptr_restrict. Enabling this option is dangerous and
		THIS OPTION MUST BE DISABLED ON PRODUCTION BINARY.

config NPU_FW_HEADER_FILE
	bool "use NPU.bin as header file for GKI"
	default n
	help
		Can`t include Firmware binary to boot.image on GKI. So, we need
		header file to use frimware.

config NPU_STM
	bool "use STM for debugging"
	depends on CORESIGHT_STM
	default n
	help
		This feature need to analyze npu complier.

if EXYNOS_NPU

config NPU_ZEBU_EMULATION
bool
default n

config NPU_GOLDEN_MATCH
bool
default y

config NPU_ZEBU_SYSMMU
bool
default y

config FIRMWARE_SRAM_DUMP_DEBUGFS
bool
default y

source "drivers/vision/npu/core/interface/Kconfig"

config NPU_USE_MBR
	bool "use Master Boot Record for FW booting"
	default n
	help
		Because of lack of memory allocation by remapper limitation,
		use Master Boot Record for FW booting.

config NPU_PERF_FW
	bool "use performance firmware"
	default n
	help
		Because of performance test,
		use performance firmware for test.

config NPU_SCHEDULER_GOVERNOR
	bool "use scheduler and governor for power/performance control for NPU"
	depends on EXYNOS_NPU
	default y
	help
		use scheduler and governor for power/performance control for NPU

		When this option is enabled, additional module is activated for
		power / performance control for NPU HW.
		Also governor is needed to be selected for scheduler.

config NPU_GOVERNOR_SIMPLE_EXYNOS
	bool "use simple-exynos governor policy for NPU scheduler"
	depends on NPU_SCHEDULER_GOVERNOR
	default y
	help
		use simple-exynos governor policy for NPU scheduler

		Also governor is needed to be selected for NPU scheduler.
		Simple-exynos governor selects NPU-related frequecies in
		gradual manner by thresholds.

config NPU_GOVERNOR_EXYNOS_INTERACTIVE
	bool "use exynos-interactive governor policy for NPU scheduler"
	depends on NPU_SCHEDULER_GOVERNOR
	default y
	help
		use exynos-interactive governor policy for NPU scheduler

		Also governor is needed to be selected for NPU scheduler.
		Exynos-interactive governor selects NPU-related frequecies in
		gradual manner by thresholds.
		Also introduce hispeed/lowspeed ramp up.

config NPU_GOVERNOR_USERSPACE
	bool "use userspace governor policy for NPU scheduler"
	depends on NPU_SCHEDULER_GOVERNOR
	default y
	help
		Also governor is needed to be selected for NPU scheduler.
		Userspace governor directly selects NPU-related frequecies as
		preferred frequency not related to load.

config NPU_USE_SPROFILER
	bool "use S-profiler for debugging"
	default n
	help
		use S-profiler for debugging

		S-profiler for internal use

config NPU_USE_VOTF
	bool "use virtual-OTF function"
	default n
	help
		use virtual-OTF function

		vOTF for internal use

config NPU_ARBITRATION
	bool "enable NPU core arbitration support"
	default n
	help
		When this option is enabled, the NPU core arbitration
		algorithm monitors the workload and allows some of the
		NPU cores to be turned OFF for power saving.

		NPU core arbitration for internal use

endif
```

## drivers/vision/vision-core/Kconfig
```kconfig
config VISION_CORE
        bool "Vision Core"
        help
	  Vision core module enablement

          Vision core module handles all vision related
          modules.
	  Enabling this module enables NPU, and related
	  support code.

menuconfig VISION_CORE_M
	tristate "Vision Core Module"
	depends on VISION_CORE
	help
		Support module build

menuconfig VISION_UNITTEST
        bool "Build unittest for Vision"
        depends on VISION_CORE
        help
	  Include unittest code into the vision-core
```

## sound/soc/samsung/abox/Kconfig
```kconfig
config SND_SOC_SAMSUNG_ABOX
	tristate "ASoC support for Samsung ABOX Audio"
	select REGMAP_MMIO
	select SND_SOC_COMPRESS
	select SND_SOC_TOPOLOGY
	select SND_HWDEP
	help
	  Say Y or M if you want to add support for codecs attached to
	  the Samsung SoC ABOX interface. You will also need to
	  select the audio interfaces to support below.

config SND_SOC_SAMSUNG_ABOX_VERSION
	hex "ABOX IP version"
	depends on SND_SOC_SAMSUNG_ABOX
	default 0x10000 if SOC_EXYNOS8895
	default 0x10100 if SOC_EXYNOS9810
	default 0x11100 if SOC_EXYNOS9610
	default 0x12100 if SOC_EXYNOS7872
	default 0x12300 if SOC_EXYNOS7885
	default 0x20000 if SOC_EXYNOS9820 && SOC_EXYNOS9820_EVT0
	default 0x20001 if SOC_EXYNOS9820
	default 0x21000 if SOC_EXYNOS9630
	default 0x30000 if SOC_EXYNOS9830 && SOC_EXYNOS9830_EVT0
	default 0x30001 if SOC_EXYNOS9830
	default 0x30100 if SOC_EXYNOS2100 && SOC_EXYNOS2100_EVT0
	default 0x30101 if SOC_EXYNOS2100
	help
	  Version of ABOX IP.
	  Value = 0x10000 * major + 0x100 * minor + rev.
	  Ex. 1.01 rev0 => 0x10100, 1.25 rev1 => 0x12501

config SND_SOC_SAMSUNG_ABOX_UDMA
	bool
	depends on SND_SOC_SAMSUNG_ABOX
	default n if SND_SOC_SAMSUNG_ABOX_VERSION < 0x30100
	default y if SND_SOC_SAMSUNG_ABOX_VERSION >= 0x30100

config SND_SOC_SAMSUNG_ABOX_V1
	bool
	depends on SND_SOC_SAMSUNG_ABOX
	default y if SND_SOC_SAMSUNG_ABOX_VERSION < 0x20000
	default n if SND_SOC_SAMSUNG_ABOX_VERSION >= 0x20000

config SND_SOC_SAMSUNG_ABOX_V2
	bool
	depends on SND_SOC_SAMSUNG_ABOX
	default n if SND_SOC_SAMSUNG_ABOX_VERSION < 0x20000
	default y if SND_SOC_SAMSUNG_ABOX_VERSION >= 0x20000 \
		&& SND_SOC_SAMSUNG_ABOX_VERSION < 0x21000

config SND_SOC_SAMSUNG_ABOX_V3
	bool
	depends on SND_SOC_SAMSUNG_ABOX
	default n if SND_SOC_SAMSUNG_ABOX_VERSION < 0x21000
	default y if SND_SOC_SAMSUNG_ABOX_VERSION >= 0x21000 \
		&& SND_SOC_SAMSUNG_ABOX_VERSION < 0x30100

config SND_SOC_SAMSUNG_ABOX_V3_1
	bool
	depends on SND_SOC_SAMSUNG_ABOX
	default n if SND_SOC_SAMSUNG_ABOX_VERSION < 0x30100
	default y if SND_SOC_SAMSUNG_ABOX_VERSION >= 0x30100

config SND_SOC_SAMSUNG_ABOX_DRAM_SIZE
	hex "Size of DRAM for ABOX firmware"
	default 0x1200000 if SND_SOC_SAMSUNG_ABOX_V1
	default 0x1A00000 if SND_SOC_SAMSUNG_ABOX_V2
	default 0x2800000 if SND_SOC_SAMSUNG_ABOX_V3
	default 0x2800000 if SND_SOC_SAMSUNG_ABOX_V3_1

config SND_SOC_SAMSUNG_ABOX_DEBUG
	bool "Debug mode for ABOX"
	depends on SND_SOC_SAMSUNG_ABOX
	default n

config SEC_SND_ADAPTATION
	tristate "Samsung ABOX Adaptation for Audio"
	depends on SND_SOC_SAMSUNG_ABOX
	help
	  Say Y or M if you want to add support for external devices attached to
	  the Samsung SoC ABOX interface. You will also need to
	  select the audio interfaces to support below.

config SND_SOC_SAMSUNG_ABOX_CHANGE_RMEM_SIZE
	tristate "Release some reserved memory"
	depends on SND_SOC_SAMSUNG_ABOX
	default n
	help
	  change reserved memory size for abox_dbg or abox_slog
	  check debug_level or force_upload before alloc reserved memory and change the size.

config ABOX_TEST
	bool "KUnit test for abox_test"
	depends on SND_SOC_SAMSUNG_ABOX
	default y if SEC_KUNIT
	help
	  Kunit test for Samsung SoC ABOX.

config ABOX_SHM_TEST
	bool "KUnit test for abox_shm_test"
	depends on SND_SOC_SAMSUNG_ABOX
	default y if SEC_KUNIT
	help
	  Kunit test for Samsung SoC ABOX shm.

config ABOX_CMPNT_TEST
	bool "KUnit test for abox_cmpnt_test"
	depends on SND_SOC_SAMSUNG_ABOX
	default y if SEC_KUNIT
	help
	  Kunit test for Samsung SoC ABOX cmpnt.
```

## sound/soc/samsung/vts/Kconfig
```kconfig
config SND_SOC_SAMSUNG_MAILBOX
	tristate "Samsung MAILBOX"
	help
	  Say Y if you want to use mailbox for voice trigger system.

config SND_SOC_SAMSUNG_VTS
	tristate "Samsung VTS"
	depends on SND_SOC_SAMSUNG_MAILBOX
	help
	  Say Y if you want to use voice trigger system.

config SND_SOC_SAMSUNG_VTS_S_LIF
	tristate "Samsung VTS Serial LIF"
	depends on SND_SOC_SAMSUNG_VTS
	help
	  Say Y if you want to use Serial LIF.

config SND_SOC_SAMSUNG_VTS_S_LIF_VERSION
	hex "VTS Serial LIF IP version"
	depends on SND_SOC_SAMSUNG_VTS_S_LIF
	default 0x10000 if SOC_EXYNOS9830_EVT0
	default 0x10101 if SOC_EXYNOS9830
	default 0x10102 if SOC_EXYNOS2100_EVT0
	default 0x10101 if SOC_EXYNOS2100
	help
	  Version of VTS Serial LIF IP.
	  Value = 0x10000 * major + 0x100 * minor + rev.
	  Ex. 1.00 rev0 => 0x10000, 1.01 rev1 => 0x10101
```

## test/Kconfig
```kconfig
#
# KUnit base configuration
#

menu "KUnit support"

config SEC_KUNIT
	bool "Enable support for unit tests (KUnit)"
	select HAS_IOMEM
	help
	  Enables support for kernel unit tests (KUnit), a lightweight unit
	  testing and mocking framework for the Linux kernel. These tests are
	  able to be run locally on a developer's workstation without a VM or
	  special hardware. For more information, please see Documentation/test/

if SEC_KUNIT

config SEC_KUNIT_TEST
	bool "KUnit test for KUnit"
	depends on SEC_KUNIT
	default n
	help
	  Enables KUnit test to test KUnit.

config SEC_KUNIT_DEATH_TEST
	bool "(Expert) KUnit death test for KUnit"
	depends on SEC_KUNIT
	default n
	help
	  Enables KUnit test to test KUnit death test feature. This test is not
	  hermetic and can cause other tests to misbehave.

config EXAMPLE_TEST
	bool "Example test for KUnit"
	depends on SEC_KUNIT
	default n
	help
	  Enables example KUnit test to demo features of KUnit.

config KUNIT_TEST_WRAPPER_TEST
	tristate "KUnit test for mainline 5.10 KUnit"
	depends on SEC_KUNIT
	default n
	help
	  Enables the unit tests for the 5.10 KUnit test framework. This test helps users understand how to 5.10
	  Kunit macros. Please refer to the example test, test/mainline_test. Note that, this cannot test
	  mocking test.

config SEC_KUNIT_MANAGER
	tristate "Manager for KUnit"
	depends on SEC_KUNIT && !UML
	default m
	help
	  Enables KUnit Manager.

endif # SEC_KUNIT

endmenu
```
